## CMakeLists.txt
```
#
# Copyright (c) 2022 Nordic Semiconductor ASA
#
# SPDX-License-Identifier: LicenseRef-Nordic-5-Clause
#

cmake_minimum_required(VERSION 3.20.0)

find_package(Zephyr HINTS $ENV{ZEPHYR_BASE})

project(matter-bridge)

set(COMMON_ROOT ${ZEPHYR_NRF_MODULE_DIR}/samples/matter/common)
set(NLIO_ROOT ${ZEPHYR_CONNECTEDHOMEIP_MODULE_DIR}/third_party/nlio/repo)
include(${ZEPHYR_CONNECTEDHOMEIP_MODULE_DIR}/config/nrfconnect/app/enable-gnu-std.cmake)
include(${ZEPHYR_CONNECTEDHOMEIP_MODULE_DIR}/src/app/chip_data_model.cmake)

# NORDIC SDK APP START
target_include_directories(app PRIVATE
    src
    ${COMMON_ROOT}/src
    ${NLIO_ROOT}/include
    ${ZEPHYR_CONNECTEDHOMEIP_MODULE_DIR}/zzz_generated/app-common
)

target_sources(app PRIVATE
    src/app_task.cpp
    src/main.cpp
    src/zigbee_shell.cpp
    src/Device.cpp
    src/zap-generated/IMClusterCommandHandler.cpp
    src/zap-generated/callback-stub.cpp
    ${COMMON_ROOT}/src/led_widget.cpp
    ${COMMON_ROOT}/src/thread_util.cpp
)

chip_configure_data_model(app
    INCLUDE_SERVER
    ZAP_FILE ${CMAKE_CURRENT_SOURCE_DIR}/src/bridge.zap
)
# NORDIC SDK APP END
```

## Kconfig
```
#
# Copyright (c) 2022 Nordic Semiconductor
#
# SPDX-License-Identifier: LicenseRef-Nordic-5-Clause
#

source "Kconfig.zephyr"

menu "Matter Bridge"

config ZIGBEE_SHELL_DEVICE_NAME
	string "UART device name for Zigbee shell"
	default "UART_1"

endmenu
```

## sample.yaml
```
sample:
  name: Matter Bridge
  description: Matter Bridge sample
tests:
  matter.bridge:
    build_only: true
    platform_allow: nrf52840dk_nrf52840 nrf5340dk_nrf5340_cpuapp nrf21540dk_nrf52840
    integration_platforms:
      - nrf52840dk_nrf52840
      - nrf5340dk_nrf5340_cpuapp
      - nrf21540dk_nrf52840
    tags: ci_build
```

## prj.conf
```kconfig
#
# Copyright (c) 2022 Nordic Semiconductor ASA
#
# SPDX-License-Identifier: LicenseRef-Nordic-5-Clause
#

# Enable CHIP
CONFIG_CHIP=y
CONFIG_CHIP_ENABLE_PAIRING_AUTOSTART=y
CONFIG_CHIP_PROJECT_CONFIG="src/chip_project_config.h"
CONFIG_STD_CPP14=y

# General networking settings
CONFIG_NETWORKING=y
CONFIG_NET_IPV6_NBR_CACHE=n
CONFIG_NET_IPV6_MLD=n
CONFIG_NET_SOCKETS_POLL_MAX=5

# Enable OpenThread MTD
CONFIG_NET_L2_OPENTHREAD=y

CONFIG_OPENTHREAD_MTD=y
CONFIG_OPENTHREAD_FTD=n
CONFIG_OPENTHREAD_SLAAC=y
CONFIG_OPENTHREAD_MTD_NETDIAG=y
CONFIG_OPENTHREAD_MANUAL_START=y
CONFIG_OPENTHREAD_THREAD_STACK_SIZE=6144
CONFIG_OPENTHREAD_NUM_MESSAGE_BUFFERS=64

CONFIG_OPENTHREAD_PANID=4660
CONFIG_OPENTHREAD_CHANNEL=15
CONFIG_OPENTHREAD_NETWORK_NAME="OpenThread"
CONFIG_OPENTHREAD_XPANID="11:11:11:11:22:22:22:22"

# Enable Thread 1.2 features
CONFIG_OPENTHREAD_THREAD_VERSION_1_2=y
CONFIG_OPENTHREAD_DUA=y
CONFIG_OPENTHREAD_MLR=y

# Enable Bluetooth Low Energy
CONFIG_BT=y
CONFIG_BT_PERIPHERAL=y
CONFIG_BT_PERIPHERAL_PREF_MIN_INT=12
CONFIG_BT_PERIPHERAL_PREF_MAX_INT=12
CONFIG_BT_GAP_AUTO_UPDATE_CONN_PARAMS=y
CONFIG_BT_GATT_DYNAMIC_DB=y
CONFIG_BT_DEVICE_APPEARANCE=0
CONFIG_BT_DEVICE_NAME_DYNAMIC=y
CONFIG_BT_DEVICE_NAME_MAX=15
CONFIG_BT_DEVICE_NAME="MatterBridge"
CONFIG_BT_MAX_CONN=1

# Use nrf_security
CONFIG_OPENTHREAD_NRF_SECURITY_CHOICE=y

CONFIG_CC3XX_BACKEND=n
CONFIG_OBERON_BACKEND=y

CONFIG_MBEDTLS_ENABLE_HEAP=y
CONFIG_MBEDTLS_HEAP_SIZE=15360
CONFIG_MBEDTLS_TLS_LIBRARY=y
CONFIG_NRF_SECURITY_ADVANCED=y

CONFIG_MBEDTLS_AES_C=y
CONFIG_MBEDTLS_ECP_C=y
CONFIG_MBEDTLS_ECP_DP_SECP256R1_ENABLED=y
CONFIG_MBEDTLS_CTR_DRBG_C=y
CONFIG_MBEDTLS_CIPHER_MODE_CTR=y
CONFIG_MBEDTLS_ECJPAKE_C=y
CONFIG_MBEDTLS_SHA256_C=y
CONFIG_MBEDTLS_PK_C=y
CONFIG_MBEDTLS_PK_WRITE_C=y
CONFIG_MBEDTLS_X509_CREATE_C=y
CONFIG_MBEDTLS_X509_CSR_WRITE_C=y

# Disable unneeded crypto operations
CONFIG_MBEDTLS_SHA384_C=n
CONFIG_MBEDTLS_SHA512_C=n
CONFIG_MBEDTLS_CIPHER_MODE_XTS=n
CONFIG_MBEDTLS_CHACHA20_C=n
CONFIG_MBEDTLS_POLY1305_C=n
CONFIG_MBEDTLS_CHACHAPOLY_C=n
CONFIG_MBEDTLS_GCM_C=n
CONFIG_MBEDTLS_RSA_C=n

# Add support for LEDs and buttons on Nordic development kits
CONFIG_DK_LIBRARY=y

# Other settings
CONFIG_LOG=y
CONFIG_LOG_MODE_MINIMAL=y
CONFIG_MATTER_LOG_LEVEL_DBG=y
CONFIG_PRINTK_SYNC=y
CONFIG_MAIN_STACK_SIZE=8192
CONFIG_INIT_STACKS=y
CONFIG_HW_STACK_PROTECTION=y
CONFIG_HWINFO=y
CONFIG_THREAD_NAME=y
CONFIG_SHELL=y

CONFIG_SERIAL=y
CONFIG_UART_ASYNC_API=y
CONFIG_UART_1_ASYNC=y
CONFIG_UART_1_INTERRUPT_DRIVEN=n
CONFIG_UART_1_NRF_HW_ASYNC=y
CONFIG_UART_1_NRF_HW_ASYNC_TIMER=2
CONFIG_NRFX_TIMER2=y
```

## boards/nrf52840dk_nrf52840.overlay
```dts
/* Copyright (c) 2022 Nordic Semiconductor ASA
 *
 * SPDX-License-Identifier: LicenseRef-Nordic-5-Clause
 */

/ {
	/*
	* In some default configurations within the nRF Connect SDK,
	* e.g. on nRF52840, the chosen zephyr,entropy node is &cryptocell.
	* This devicetree overlay ensures that default is overridden wherever it
	* is set, as this application uses the RNG node for entropy exclusively.
	*/
	chosen {
		zephyr,entropy = &rng;
	};
};
```

## boards/nrf5340dk_nrf5340_cpuapp.overlay
```dts
/* Copyright (c) 2022 Nordic Semiconductor ASA
 *
 * SPDX-License-Identifier: LicenseRef-Nordic-5-Clause
 */
&i2c1 {
	status = "disabled";
};

&uart1 {
	status = "okay";
	tx-pin = <34>;
	rx-pin = <35>;
};
```

## src/main.cpp
```c
/*
 * Copyright (c) 2022 Nordic Semiconductor ASA
 *
 * SPDX-License-Identifier: LicenseRef-Nordic-5-Clause
 */

#include "app_task.h"

#include <logging/log.h>

#include <lib/support/CHIPMem.h>
#include <platform/CHIPDeviceLayer.h>

LOG_MODULE_REGISTER(app);

using namespace ::chip::DeviceLayer;

int main()
{
	int ret = 0;
	CHIP_ERROR err = CHIP_NO_ERROR;

	err = chip::Platform::MemoryInit();
	if (err != CHIP_NO_ERROR) {
		LOG_ERR("Platform::MemoryInit() failed");
		goto exit;
	}

	LOG_INF("Init CHIP stack");
	err = PlatformMgr().InitChipStack();
	if (err != CHIP_NO_ERROR) {
		LOG_ERR("PlatformMgr().InitChipStack() failed");
		goto exit;
	}

	LOG_INF("Starting CHIP task");
	err = PlatformMgr().StartEventLoopTask();
	if (err != CHIP_NO_ERROR) {
		LOG_ERR("PlatformMgr().StartEventLoopTask() failed");
		goto exit;
	}

	LOG_INF("Init Thread stack");
	err = ThreadStackMgr().InitThreadStack();
	if (err != CHIP_NO_ERROR) {
		LOG_ERR("ThreadStackMgr().InitThreadStack() failed");
		goto exit;
	}

	err = ConnectivityMgr().SetThreadDeviceType(ConnectivityManager::kThreadDeviceType_MinimalEndDevice);
	if (err != CHIP_NO_ERROR) {
		LOG_ERR("ConnectivityMgr().SetThreadDeviceType() failed");
		goto exit;
	}

	ret = GetAppTask().StartApp();
	if (ret != 0) {
		err = chip::System::MapErrorZephyr(ret);
	}

exit:
	return err == CHIP_NO_ERROR ? EXIT_SUCCESS : EXIT_FAILURE;
}
```

## src/Device.cpp
```c
/*
 *
 *    Copyright (c) 2020 Project CHIP Authors
 *
 *    Licensed under the Apache License, Version 2.0 (the "License");
 *    you may not use this file except in compliance with the License.
 *    You may obtain a copy of the License at
 *
 *        http://www.apache.org/licenses/LICENSE-2.0
 *
 *    Unless required by applicable law or agreed to in writing, software
 *    distributed under the License is distributed on an "AS IS" BASIS,
 *    WITHOUT WARRANTIES OR CONDITIONS OF ANY KIND, either express or implied.
 *    See the License for the specific language governing permissions and
 *    limitations under the License.
 */

#include "Device.h"

#include <cstdio>
#include <lib/support/CHIPMemString.h>
#include <platform/CHIPDeviceLayer.h>

using namespace ::chip::Platform;

Device::Device(void)
{
	CopyString(mName, sizeof(mName), "none");
	CopyString(mLocation, sizeof(mLocation), "none");
	mState	  = kState_Off;
	mReachable  = false;
	mEndpointId = 0;
	mChanged_CB = nullptr;
}

Device::Device(const char * szDeviceName, const char * szLocation)
{
	CopyString(mName, sizeof(mName), szDeviceName);
	CopyString(mLocation, sizeof(mLocation), szLocation);
	mState	  = kState_Off;
	mReachable  = false;
	mEndpointId = 0;
	mChanged_CB = nullptr;
}

bool Device::IsOn() const
{
	return mState == kState_On;
}

bool Device::IsReachable() const
{
	return mReachable;
}

void Device::SetOnOff(bool aOn)
{
	bool changed;

	if (aOn)
	{
		changed = (mState != kState_On);
		mState  = kState_On;
		ChipLogProgress(DeviceLayer, "Device[%s]: ON", mName);
	}
	else
	{
		changed = (mState != kState_Off);
		mState  = kState_Off;
		ChipLogProgress(DeviceLayer, "Device[%s]: OFF", mName);
	}

	if (changed && mChanged_CB)
	{
		mChanged_CB(this, kChanged_State);
	}
}

void Device::SetReachable(bool aReachable)
{
	bool changed = (mReachable != aReachable);

	mReachable = aReachable;

	if (aReachable)
	{
		ChipLogProgress(DeviceLayer, "Device[%s]: ONLINE", mName);
	}
	else
	{
		ChipLogProgress(DeviceLayer, "Device[%s]: OFFLINE", mName);
	}

	if (changed && mChanged_CB)
	{
		mChanged_CB(this, kChanged_Reachable);
	}
}

void Device::SetName(const char * szName)
{
	bool changed = (strncmp(mName, szName, sizeof(mName)) != 0);

	ChipLogProgress(DeviceLayer, "Device[%s]: New Name=\"%s\"", mName, szName);

	CopyString(mName, sizeof(mName), szName);

	if (changed && mChanged_CB)
	{
		mChanged_CB(this, kChanged_Name);
	}
}

void Device::SetLocation(const char * szLocation)
{
	bool changed = (strncmp(mLocation, szLocation, sizeof(mLocation)) != 0);

	CopyString(mLocation, sizeof(mLocation), szLocation);

	ChipLogProgress(DeviceLayer, "Device[%s]: Location=\"%s\"", mName, mLocation);

	if (changed && mChanged_CB)
	{
		mChanged_CB(this, kChanged_Location);
	}
}

void Device::SetZbAddr(uint16_t aZbAddr)
{
	mZbAddr = aZbAddr;
}

void Device::SetZbEp(uint8_t aZbEp)
{
	mZbEp = aZbEp;
}

void Device::SetChangeCallback(DeviceCallback_fn aChanged_CB)
{
	mChanged_CB = aChanged_CB;
}
```

## src/Device.h
```c
/*
 *
 *    Copyright (c) 2021 Project CHIP Authors
 *
 *    Licensed under the Apache License, Version 2.0 (the "License");
 *    you may not use this file except in compliance with the License.
 *    You may obtain a copy of the License at
 *
 *        http://www.apache.org/licenses/LICENSE-2.0
 *
 *    Unless required by applicable law or agreed to in writing, software
 *    distributed under the License is distributed on an "AS IS" BASIS,
 *    WITHOUT WARRANTIES OR CONDITIONS OF ANY KIND, either express or implied.
 *    See the License for the specific language governing permissions and
 *    limitations under the License.
 */

#include <app/util/attribute-storage.h>
#include <functional>
#include <stdbool.h>
#include <stdint.h>

class Device
{
public:
	static const int kDeviceNameSize	 = 32;
	static const int kDeviceLocationSize = 32;

	enum State_t
	{
		kState_On = 0,
		kState_Off,
	} State;

	enum Changed_t
	{
		kChanged_Reachable = 0x01,
		kChanged_State	 = 0x02,
		kChanged_Location  = 0x04,
		kChanged_Name	  = 0x08,
	} Changed;

	Device();
	Device(const char * szDeviceName, const char * szLocation);

	bool IsOn() const;
	bool IsReachable() const;
	void SetOnOff(bool aOn);
	void SetReachable(bool aReachable);
	void SetName(const char * szDeviceName);
	void SetLocation(const char * szLocation);
	void SetZbAddr(uint16_t aZbAddr);
	void SetZbEp(uint8_t aZbEp);
	inline void SetEndpointId(chip::EndpointId id) { mEndpointId = id; };
	inline chip::EndpointId GetEndpointId() { return mEndpointId; };
	inline char * GetName() { return mName; };
	inline char * GetLocation() { return mLocation; };
	inline uint16_t GetZbAddr() { return mZbAddr; };
	inline uint8_t GetZbEp() { return mZbEp; };

	using DeviceCallback_fn = std::function<void(Device *, Changed_t)>;
	void SetChangeCallback(DeviceCallback_fn aChanged_CB);

private:
	State_t mState;
	bool mReachable;
	char mName[kDeviceNameSize];
	char mLocation[kDeviceLocationSize];
	chip::EndpointId mEndpointId;
	DeviceCallback_fn mChanged_CB;
	uint16_t mZbAddr;
	uint8_t mZbEp;
};
```

## src/app_event.h
```c
/*
 * Copyright (c) 2022 Nordic Semiconductor ASA
 *
 * SPDX-License-Identifier: LicenseRef-Nordic-5-Clause
 */

#pragma once

#include <cstdint>

#include "led_widget.h"
#include "zigbee_shell.h"

struct AppEvent {
	enum LightEventType : uint8_t { On, Off, Toggle, Level };

	enum EventType : uint8_t { FunctionPress = Level + 1, FunctionRelease, FunctionTimer };

	enum UpdateLedStateEventType : uint8_t { UpdateLedState = FunctionTimer + 1 };

	enum ZigbeeShellEventType : uint8_t {
		NetworkRejoin = UpdateLedState + 1,
		DeviceAnnounceRsp,
		ActiveEpRsp,
		SimpleDescRsp,
		StartNetworkSteering
	};

	AppEvent() = default;
	explicit AppEvent(EventType type) : Type(type) {}
	AppEvent(UpdateLedStateEventType type, LEDWidget *ledWidget) : Type(type), UpdateLedStateEvent{ ledWidget } {}
	AppEvent(ZigbeeShellEventType type) : Type(type) {}
	AppEvent(ZigbeeShellEventType type, struct ZigbeeShell::BdbEvent bdbEvent) : Type(type), bdb(bdbEvent) {}
	AppEvent(ZigbeeShellEventType type, struct ZigbeeShell::ZdoEvent zdoEvent) : Type(type), zdo{ zdoEvent } {}

	uint8_t Type;
	union {
		struct {
			LEDWidget *LedWidget;
		} UpdateLedStateEvent;
		struct ZigbeeShell::BdbEvent bdb;
		struct ZigbeeShell::ZdoEvent zdo;
	};
};
```

## src/app_task.cpp
```c
/*
 * Copyright (c) 2022 Nordic Semiconductor ASA
 *
 * SPDX-License-Identifier: LicenseRef-Nordic-5-Clause
 */

#include "app_task.h"
#include "led_widget.h"
#include "zigbee_shell.h"
#include "Device.h"

#include <platform/CHIPDeviceLayer.h>

#include <app/server/OnboardingCodesUtil.h>
#include <app/server/Server.h>
#include <credentials/DeviceAttestationCredsProvider.h>
#include <credentials/examples/DeviceAttestationCredsExample.h>
#include <app-common/zap-generated/af-structs.h>
#include <app-common/zap-generated/attribute-id.h>
#include <app-common/zap-generated/cluster-id.h>
#include <app/reporting/reporting.h>
#include <vector>

#include <dk_buttons_and_leds.h>
#include <logging/log.h>
#include <zephyr.h>

using namespace ::chip;
using namespace ::chip::Credentials;
using namespace ::chip::DeviceLayer;

LOG_MODULE_DECLARE(app);

namespace
{
static constexpr size_t kAppEventQueueSize = 10;
static constexpr uint32_t kFactoryResetTriggerTimeout = 6000;

K_MSGQ_DEFINE(sAppEventQueue, sizeof(AppEvent), kAppEventQueueSize, alignof(AppEvent));
LEDWidget sStatusLED;
LEDWidget sUnusedLED;
LEDWidget sUnusedLED_1;
LEDWidget sUnusedLED_2;

ZigbeeShell sZbShell;

#define ZB_HA_DIMMABLE_LIGHT_DEVICE_ID  0x0101
#define ZB_AF_HA_PROFILE_ID		0x0104

static const int kNodeLabelSize = 32;
// Current ZCL implementation of Struct uses a max-size array of 254 bytes
static const int kDescriptorAttributeArraySize = 254;
static const int kFixedLabelAttributeArraySize = 254;

static EndpointId gCurrentEndpointId;
static EndpointId gFirstDynamicEndpointId;
static Device * gDevices[CHIP_DEVICE_CONFIG_DYNAMIC_ENDPOINT_COUNT]; // number of dynamic endpoints count

// 4 Bridged devices
//std::vector<Device> Lights(CHIP_DEVICE_CONFIG_DYNAMIC_ENDPOINT_COUNT, Device("Default", "None"));
std::vector<Device> Lights(CHIP_DEVICE_CONFIG_DYNAMIC_ENDPOINT_COUNT, Device());

// (taken from chip-devices.xml)
#define DEVICE_TYPE_CHIP_BRIDGE 0x0a0b
// (taken from lo-devices.xml)
#define DEVICE_TYPE_LO_ON_OFF_LIGHT 0x0100
// Device Version for dynamic endpoints:
#define DEVICE_VERSION_DEFAULT 1

/* BRIDGED DEVICE ENDPOINT: contains the following clusters:
   - On/Off
   - Descriptor
   - Bridged Device Basic
   - Fixed Label
*/

// Declare On/Off cluster attributes
DECLARE_DYNAMIC_ATTRIBUTE_LIST_BEGIN(onOffAttrs)
DECLARE_DYNAMIC_ATTRIBUTE(ZCL_ON_OFF_ATTRIBUTE_ID, BOOLEAN, 1, 0), /* on/off */
	DECLARE_DYNAMIC_ATTRIBUTE_LIST_END();

// Declare Descriptor cluster attributes
DECLARE_DYNAMIC_ATTRIBUTE_LIST_BEGIN(descriptorAttrs)
DECLARE_DYNAMIC_ATTRIBUTE(ZCL_DEVICE_LIST_ATTRIBUTE_ID, ARRAY, kDescriptorAttributeArraySize, 0),     /* device list */
	DECLARE_DYNAMIC_ATTRIBUTE(ZCL_SERVER_LIST_ATTRIBUTE_ID, ARRAY, kDescriptorAttributeArraySize, 0), /* server list */
	DECLARE_DYNAMIC_ATTRIBUTE(ZCL_CLIENT_LIST_ATTRIBUTE_ID, ARRAY, kDescriptorAttributeArraySize, 0), /* client list */
	DECLARE_DYNAMIC_ATTRIBUTE(ZCL_PARTS_LIST_ATTRIBUTE_ID, ARRAY, kDescriptorAttributeArraySize, 0),  /* parts list */
	DECLARE_DYNAMIC_ATTRIBUTE_LIST_END();

// Declare Bridged Device Basic information cluster attributes
DECLARE_DYNAMIC_ATTRIBUTE_LIST_BEGIN(bridgedDeviceBasicAttrs)
DECLARE_DYNAMIC_ATTRIBUTE(ZCL_NODE_LABEL_ATTRIBUTE_ID, CHAR_STRING, kNodeLabelSize, 0), /* NodeLabel */
	DECLARE_DYNAMIC_ATTRIBUTE(ZCL_REACHABLE_ATTRIBUTE_ID, BOOLEAN, 1, 0),               /* Reachable */
	DECLARE_DYNAMIC_ATTRIBUTE_LIST_END();

// Declare Fixed Label cluster attributes
DECLARE_DYNAMIC_ATTRIBUTE_LIST_BEGIN(fixedLabelAttrs)
DECLARE_DYNAMIC_ATTRIBUTE(ZCL_LABEL_LIST_ATTRIBUTE_ID, ARRAY, kFixedLabelAttributeArraySize, 0), /* label list */
	DECLARE_DYNAMIC_ATTRIBUTE_LIST_END();

// Declare Cluster List for Bridged Light endpoint
DECLARE_DYNAMIC_CLUSTER_LIST_BEGIN(bridgedLightClusters)
DECLARE_DYNAMIC_CLUSTER(ZCL_ON_OFF_CLUSTER_ID, onOffAttrs), DECLARE_DYNAMIC_CLUSTER(ZCL_DESCRIPTOR_CLUSTER_ID, descriptorAttrs),
	DECLARE_DYNAMIC_CLUSTER(ZCL_BRIDGED_DEVICE_BASIC_CLUSTER_ID, bridgedDeviceBasicAttrs),
	DECLARE_DYNAMIC_CLUSTER(ZCL_FIXED_LABEL_CLUSTER_ID, fixedLabelAttrs) DECLARE_DYNAMIC_CLUSTER_LIST_END;

// Declare Bridged Light endpoint
DECLARE_DYNAMIC_ENDPOINT(bridgedLightEndpoint, bridgedLightClusters);

/* REVISION definitions:
 */

#define ZCL_DESCRIPTOR_CLUSTER_REVISION (1u)
#define ZCL_BRIDGED_DEVICE_BASIC_CLUSTER_REVISION (1u)
#define ZCL_FIXED_LABEL_CLUSTER_REVISION (1u)
#define ZCL_ON_OFF_CLUSTER_REVISION (4u)

bool sIsThreadProvisioned;
bool sIsThreadEnabled;
bool sHaveBLEConnections;

k_timer sFunctionTimer;
} /* namespace */

AppTask AppTask::sAppTask;

CHIP_ERROR AddDeviceEndpoint(Device * dev, EmberAfEndpointType * ep, uint16_t deviceType)
{
	uint8_t index = 0;
	while (index < CHIP_DEVICE_CONFIG_DYNAMIC_ENDPOINT_COUNT)
	{
		if (NULL == gDevices[index])
		{
			gDevices[index] = dev;
			EmberAfStatus ret;
			ret = emberAfSetDynamicEndpoint(index, gCurrentEndpointId, ep, deviceType, DEVICE_VERSION_DEFAULT);
			if (ret == EMBER_ZCL_STATUS_SUCCESS)
			{
				ChipLogProgress(DeviceLayer, "Added device %s to dynamic endpoint %d (index=%d)", dev->GetName(),
						gCurrentEndpointId, index);
				gCurrentEndpointId++;
				return CHIP_NO_ERROR;
			}
			else if (ret != EMBER_ZCL_STATUS_DUPLICATE_EXISTS)
			{
				ChipLogProgress(DeviceLayer, "Failed to add dynamic endpoint, Insufficient space");
				return CHIP_ERROR_INTERNAL;
			}
		}
		index++;
	}
	ChipLogProgress(DeviceLayer, "Failed to add dynamic endpoint: No endpoints available!");
	return CHIP_ERROR_INTERNAL;
}

CHIP_ERROR RemoveDeviceEndpoint(Device * dev)
{
	for (uint8_t index = 0; index < CHIP_DEVICE_CONFIG_DYNAMIC_ENDPOINT_COUNT; index++)
	{
		if (gDevices[index] == dev)
		{
			EndpointId ep   = emberAfClearDynamicEndpoint(index);
			gDevices[index] = NULL;
			ChipLogProgress(DeviceLayer, "Removed device %s from dynamic endpoint %d (index=%d)", dev->GetName(), ep, index);
			// Silence complaints about unused ep when progress logging
			// disabled.
			UNUSED_VAR(ep);
			return CHIP_NO_ERROR;
		}
	}
	return CHIP_ERROR_INTERNAL;
}

// ZCL format -> (len, string)
uint8_t * ToZclCharString(uint8_t * zclString, const char * cString, uint8_t maxLength)
{
	size_t len = strlen(cString);
	if (len > maxLength)
	{
		len = maxLength;
	}
	zclString[0] = static_cast<uint8_t>(len);
	memcpy(&zclString[1], cString, zclString[0]);
	return zclString;
}

// Converted into bytes and mapped the (label, value)
void EncodeFixedLabel(const char * label, const char * value, uint8_t * buffer, uint16_t length, EmberAfAttributeMetadata * am)
{
	_LabelStruct labelStruct;

	labelStruct.label = chip::CharSpan::fromCharString(label);
	labelStruct.value = chip::CharSpan::fromCharString(value);

	// TODO: Need to set up an AttributeAccessInterface to handle the lists here.
}

EmberAfStatus HandleReadBridgedDeviceBasicAttribute(Device * dev, chip::AttributeId attributeId, uint8_t * buffer,
						    uint16_t maxReadLength)
{
	ChipLogProgress(DeviceLayer, "HandleReadBridgedDeviceBasicAttribute: attrId=%d, maxReadLength=%d", attributeId, maxReadLength);

	if ((attributeId == ZCL_REACHABLE_ATTRIBUTE_ID) && (maxReadLength == 1))
	{
		*buffer = dev->IsReachable() ? 1 : 0;
	}
	else if ((attributeId == ZCL_NODE_LABEL_ATTRIBUTE_ID) && (maxReadLength == 32))
	{
		ToZclCharString(buffer, dev->GetName(), static_cast<uint8_t>(maxReadLength - 1));
	}
	else if ((attributeId == ZCL_CLUSTER_REVISION_SERVER_ATTRIBUTE_ID) && (maxReadLength == 2))
	{
		*buffer = (uint16_t) ZCL_BRIDGED_DEVICE_BASIC_CLUSTER_REVISION;
	}
	else
	{
		return EMBER_ZCL_STATUS_FAILURE;
	}

	return EMBER_ZCL_STATUS_SUCCESS;
}

EmberAfStatus HandleReadFixedLabelAttribute(Device * dev, EmberAfAttributeMetadata * am, uint8_t * buffer, uint16_t maxReadLength)
{
	if ((am->attributeId == ZCL_LABEL_LIST_ATTRIBUTE_ID) && (maxReadLength <= kFixedLabelAttributeArraySize))
	{
		EncodeFixedLabel("room", dev->GetLocation(), buffer, maxReadLength, am);
	}
	else if ((am->attributeId == ZCL_CLUSTER_REVISION_SERVER_ATTRIBUTE_ID) && (maxReadLength == 2))
	{
		*buffer = (uint16_t) ZCL_FIXED_LABEL_CLUSTER_REVISION;
	}
	else
	{
		return EMBER_ZCL_STATUS_FAILURE;
	}

	return EMBER_ZCL_STATUS_SUCCESS;
}

EmberAfStatus HandleReadOnOffAttribute(Device * dev, chip::AttributeId attributeId, uint8_t * buffer, uint16_t maxReadLength)
{
	ChipLogProgress(DeviceLayer, "HandleReadOnOffAttribute: attrId=%d, maxReadLength=%d", attributeId, maxReadLength);

	if ((attributeId == ZCL_ON_OFF_ATTRIBUTE_ID) && (maxReadLength == 1))
	{
		*buffer = dev->IsOn() ? 1 : 0;
	}
	else if ((attributeId == ZCL_CLUSTER_REVISION_SERVER_ATTRIBUTE_ID) && (maxReadLength == 2))
	{
		*buffer = (uint16_t) ZCL_ON_OFF_CLUSTER_REVISION;
	}
	else
	{
		return EMBER_ZCL_STATUS_FAILURE;
	}

	return EMBER_ZCL_STATUS_SUCCESS;
}

EmberAfStatus HandleWriteOnOffAttribute(Device * dev, chip::AttributeId attributeId, uint8_t * buffer)
{
	ChipLogProgress(DeviceLayer, "HandleWriteOnOffAttribute: attrId=%d", attributeId);

	ReturnErrorCodeIf((attributeId != ZCL_ON_OFF_ATTRIBUTE_ID) || (!dev->IsReachable()), EMBER_ZCL_STATUS_FAILURE);
	dev->SetOnOff(*buffer == 1);
	sZbShell.ZclCmd(dev->GetZbAddr(), dev->GetZbEp(), ZigbeeShell::kCluster_OnOff, (*buffer == 1)?(true):(false));
	return EMBER_ZCL_STATUS_SUCCESS;
}

EmberAfStatus emberAfExternalAttributeReadCallback(EndpointId endpoint, ClusterId clusterId,
						   EmberAfAttributeMetadata * attributeMetadata, uint8_t * buffer,
						   uint16_t maxReadLength)
{
	uint16_t endpointIndex = emberAfGetDynamicIndexFromEndpoint(endpoint);

	if ((endpointIndex < CHIP_DEVICE_CONFIG_DYNAMIC_ENDPOINT_COUNT) && (gDevices[endpointIndex] != NULL))
	{
		Device * dev = gDevices[endpointIndex];

		if (clusterId == ZCL_BRIDGED_DEVICE_BASIC_CLUSTER_ID)
		{
			return HandleReadBridgedDeviceBasicAttribute(dev, attributeMetadata->attributeId, buffer, maxReadLength);
		}
		else if (clusterId == ZCL_FIXED_LABEL_CLUSTER_ID)
		{
			return HandleReadFixedLabelAttribute(dev, attributeMetadata, buffer, maxReadLength);
		}
		else if (clusterId == ZCL_ON_OFF_CLUSTER_ID)
		{
			return HandleReadOnOffAttribute(dev, attributeMetadata->attributeId, buffer, maxReadLength);
		}
	}

	return EMBER_ZCL_STATUS_FAILURE;
}

EmberAfStatus emberAfExternalAttributeWriteCallback(EndpointId endpoint, ClusterId clusterId,
						    EmberAfAttributeMetadata * attributeMetadata, uint8_t * buffer)
{
	uint16_t endpointIndex = emberAfGetDynamicIndexFromEndpoint(endpoint);

	if (endpointIndex < CHIP_DEVICE_CONFIG_DYNAMIC_ENDPOINT_COUNT)
	{
		Device * dev = gDevices[endpointIndex];

		if ((dev->IsReachable()) && (clusterId == ZCL_ON_OFF_CLUSTER_ID))
		{
			return HandleWriteOnOffAttribute(dev, attributeMetadata->attributeId, buffer);
		}
	}

	return EMBER_ZCL_STATUS_FAILURE;
}

void HandleDeviceStatusChanged(Device * dev, Device::Changed_t itemChangedMask)
{
	if (itemChangedMask & Device::kChanged_Reachable)
	{
		uint8_t reachable = dev->IsReachable() ? 1 : 0;
		MatterReportingAttributeChangeCallback(dev->GetEndpointId(), ZCL_BRIDGED_DEVICE_BASIC_CLUSTER_ID,
						       ZCL_REACHABLE_ATTRIBUTE_ID, CLUSTER_MASK_SERVER, ZCL_BOOLEAN_ATTRIBUTE_TYPE,
						       &reachable);
	}

	if (itemChangedMask & Device::kChanged_State)
	{
		uint8_t isOn = dev->IsOn() ? 1 : 0;
		MatterReportingAttributeChangeCallback(dev->GetEndpointId(), ZCL_ON_OFF_CLUSTER_ID, ZCL_ON_OFF_ATTRIBUTE_ID,
						       CLUSTER_MASK_SERVER, ZCL_BOOLEAN_ATTRIBUTE_TYPE, &isOn);
	}

	if (itemChangedMask & Device::kChanged_Name)
	{
		uint8_t zclName[kNodeLabelSize + 1];
		ToZclCharString(zclName, dev->GetName(), kNodeLabelSize);
		MatterReportingAttributeChangeCallback(dev->GetEndpointId(), ZCL_BRIDGED_DEVICE_BASIC_CLUSTER_ID,
						       ZCL_NODE_LABEL_ATTRIBUTE_ID, CLUSTER_MASK_SERVER, ZCL_CHAR_STRING_ATTRIBUTE_TYPE,
						       zclName);
	}
	if (itemChangedMask & Device::kChanged_Location)
	{
		uint8_t buffer[kFixedLabelAttributeArraySize];
		EmberAfAttributeMetadata am = { .attributeId  = ZCL_LABEL_LIST_ATTRIBUTE_ID,
						.size         = kFixedLabelAttributeArraySize,
						.defaultValue = static_cast<uint16_t>(0) };

		EncodeFixedLabel("room", dev->GetLocation(), buffer, sizeof(buffer), &am);

		MatterReportingAttributeChangeCallback(dev->GetEndpointId(), ZCL_FIXED_LABEL_CLUSTER_ID, ZCL_LABEL_LIST_ATTRIBUTE_ID,
						       CLUSTER_MASK_SERVER, ZCL_ARRAY_ATTRIBUTE_TYPE, buffer);
	}
}

int AppTask::Init()
{
	int ret;

	/* Initialize LEDs */
	LEDWidget::InitGpio();
	LEDWidget::SetStateUpdateCallback(LEDStateUpdateHandler);

	sStatusLED.Init(DK_LED1);
	sUnusedLED.Init(DK_LED2);
	sUnusedLED_1.Init(DK_LED3);
	sUnusedLED_2.Init(DK_LED4);

	UpdateStatusLED();

	memset(gDevices, 0, sizeof(gDevices));

	// Whenever bridged device changes its state
	for (size_t i = 0; i < Lights.size(); ++i)
	{
		Lights[i].SetChangeCallback(&HandleDeviceStatusChanged);
	}

	/* Init Zigbee stack */
	sZbShell.SetEventCallback(ZigbeeEventHandler);
	ret = sZbShell.BdbStart();
	if (ret) {
		LOG_ERR("BdbStart() failed");
		return ret;
	}

	/* Initialize buttons */
	ret = dk_buttons_init(ButtonEventHandler);
	if (ret) {
		LOG_ERR("dk_buttons_init() failed");
		return ret;
	}

	/* Initialize function timer */
	k_timer_init(&sFunctionTimer, &AppTask::TimerEventHandler, nullptr);
	k_timer_user_data_set(&sFunctionTimer, this);

	/* Init ZCL Data Model and start server */
	chip::Server::GetInstance().Init();

	/* Initialize device attestation config */
	SetDeviceAttestationCredentialsProvider(Examples::GetExampleDACProvider());
	ConfigurationMgr().LogDeviceConfig();
	PrintOnboardingCodes(chip::RendezvousInformationFlags(chip::RendezvousInformationFlag::kBLE));

	// Set starting endpoint id where dynamic endpoints will be assigned, which
	// will be the next consecutive endpoint id after the last fixed endpoint.
	gFirstDynamicEndpointId = static_cast<chip::EndpointId>(
		static_cast<int>(emberAfEndpointFromIndex(static_cast<uint16_t>(emberAfFixedEndpointCount() - 1))) + 1);
	gCurrentEndpointId = gFirstDynamicEndpointId;

	// Disable last fixed endpoint, which is used as a placeholder for all of the
	// supported clusters so that ZAP will generated the requisite code.
	emberAfEndpointEnableDisable(emberAfEndpointFromIndex(static_cast<uint16_t>(emberAfFixedEndpointCount() - 1)), false);

	return 0;
}

int AppTask::StartApp()
{
	int ret = Init();

	if (ret) {
		LOG_ERR("AppTask.Init() failed");
		return ret;
	}

	AppEvent event = {};

	while (true) {
		k_msgq_get(&sAppEventQueue, &event, K_FOREVER);
		DispatchEvent(event);
	}
}

void AppTask::PostEvent(const AppEvent &event)
{
	if (k_msgq_put(&sAppEventQueue, &event, K_NO_WAIT)) {
		LOG_INF("Failed to post event to app task event queue");
	}
}

void AppTask::DispatchEvent(const AppEvent &event)
{
	int err;
	uint16_t InputCluster[] = {ZigbeeShell::Cluster_t::kCluster_OnOff};
	uint16_t OutputCluster[] = {};

	switch (event.Type) {
	case AppEvent::FunctionPress:
		FunctionPressHandler();
		break;
	case AppEvent::FunctionRelease:
		FunctionReleaseHandler();
		break;
	case AppEvent::FunctionTimer:
		FunctionTimerEventHandler();
		break;
	case AppEvent::UpdateLedState:
		event.UpdateLedStateEvent.LedWidget->UpdateState();
		break;
	case AppEvent::NetworkRejoin:
		err = sZbShell.ZdoMatchDesc(0xfffd, 0xfffd, ZB_AF_HA_PROFILE_ID, 1, InputCluster, 0, OutputCluster);
		if (err) {
			LOG_ERR("Fail to broadcast MatchDesc");
		}
		break;
	case AppEvent::DeviceAnnounceRsp:
		err = sZbShell.ZdoActiveEpReq(event.zdo.addr);
		if (err) {
			LOG_ERR("Fail to request active ep");
		}
		break;
	case AppEvent::ActiveEpRsp:
		err = sZbShell.ZdoSimpleDescReq(event.zdo.addr, event.zdo.ep);
		if (err) {
			LOG_ERR("Fail to request simple descriptor");
		}
		break;
	case AppEvent::SimpleDescRsp:
		err = sZbShell.ZclAttrRead(event.zdo.addr,
					   event.zdo.ep,
					   ZB_AF_HA_PROFILE_ID,
					   ZigbeeShell::kCluster_OnOff,
					   ZigbeeShell::kOnOffAttr_OnOff);
		if (err) {
			LOG_ERR("Fail to request simple descriptor");
		}
		break;
	case AppEvent::StartNetworkSteering:
		err = sZbShell.NetworkSteering();
		if (err) {
			LOG_ERR("Fail to start network steering");
		}
		break;
	default:
		LOG_INF("Unknown event received");
		break;
	}
}

void AppTask::FunctionPressHandler()
{
	sAppTask.StartFunctionTimer(kFactoryResetTriggerTimeout);
	sAppTask.mFunction = TimerFunction::FactoryReset;
}

void AppTask::FunctionReleaseHandler()
{
	if (sAppTask.mFunction == TimerFunction::FactoryReset) {
		sUnusedLED_2.Set(false);
		sUnusedLED_1.Set(false);
		sUnusedLED.Set(false);

		UpdateStatusLED();

		sAppTask.CancelFunctionTimer();
		sAppTask.mFunction = TimerFunction::NoneSelected;
		LOG_INF("Factory Reset has been Canceled");
	}
}

void AppTask::FunctionTimerEventHandler()
{
	if (sAppTask.mFunction == TimerFunction::FactoryReset) {
		sAppTask.mFunction = TimerFunction::NoneSelected;
		LOG_INF("Factory Reset triggered");

		sStatusLED.Set(true);
		sUnusedLED.Set(true);
		sUnusedLED_1.Set(true);
		sUnusedLED_2.Set(true);

		ConfigurationMgr().InitiateFactoryReset();
	}
}

void AppTask::LEDStateUpdateHandler(LEDWidget &ledWidget)
{
	sAppTask.PostEvent(AppEvent{ AppEvent::UpdateLedState, &ledWidget });
}

void AppTask::UpdateStatusLED()
{
	/* Update the status LED.
	 *
	 * If thread and service provisioned, keep the LED On constantly.
	 *
	 * If the system has ble connection(s) uptill the stage above, THEN blink the LED at an even
	 * rate of 100ms.
	 *
	 * Otherwise, blink the LED On for a very short time. */
	if (sIsThreadProvisioned && sIsThreadEnabled) {
		sStatusLED.Set(true);
	} else if (sHaveBLEConnections) {
		sStatusLED.Blink(100, 100);
	} else {
		sStatusLED.Blink(50, 950);
	}
}

void AppTask::ChipEventHandler(const ChipDeviceEvent *event, intptr_t /* arg */)
{
	switch (event->Type) {
	case DeviceEventType::kCHIPoBLEAdvertisingChange:
		sHaveBLEConnections = ConnectivityMgr().NumBLEConnections() != 0;
		UpdateStatusLED();
		break;
	case DeviceEventType::kThreadStateChange:
		sIsThreadProvisioned = ConnectivityMgr().IsThreadProvisioned();
		sIsThreadEnabled = ConnectivityMgr().IsThreadEnabled();
		UpdateStatusLED();
		break;
	default:
		break;
	}
}

void AppTask::ButtonEventHandler(uint32_t buttonState, uint32_t hasChanged)
{
	if (DK_BTN1_MSK & buttonState & hasChanged) {
		GetAppTask().PostEvent(AppEvent{ AppEvent::FunctionPress });
	} else if (DK_BTN1_MSK & hasChanged) {
		GetAppTask().PostEvent(AppEvent{ AppEvent::FunctionRelease });
	}

	if (DK_BTN2_MSK & buttonState & hasChanged) {
		GetAppTask().PostEvent(AppEvent{ AppEvent::StartNetworkSteering });
	}
}

void AppTask::ZigbeeEventHandler(ZigbeeShell * shell, ZigbeeShell::Event_t event)
{
	LOG_INF("Zigbee event: %d", event);
	switch (event) {
	case ZigbeeShell::kEvent_NetworkRejoin:
		GetAppTask().PostEvent(AppEvent{ AppEvent::NetworkRejoin, shell->mEvent.Bdb});
		break;
	case ZigbeeShell::kEvent_DeviceAnnounceRsp:
		GetAppTask().PostEvent(AppEvent{ AppEvent::DeviceAnnounceRsp, shell->mEvent.Zdo});
		break;
	case ZigbeeShell::kEvent_ActiveEpRsp:
		GetAppTask().PostEvent(AppEvent{ AppEvent::ActiveEpRsp, shell->mEvent.Zdo});
		break;
	case ZigbeeShell::kEvent_SimpleDescRsp:
		LOG_INF("addr:0x%04hx ep:%d dev_id:0x%04hx",
			shell->mEvent.Zdo.addr,
			shell->mEvent.Zdo.ep,
			shell->mEvent.Zdo.dev_id);
		if (shell->mEvent.Zdo.dev_id != ZB_HA_DIMMABLE_LIGHT_DEVICE_ID) {
			return;
		}
		for (auto &light : Lights)
		{
			if ((light.GetZbAddr() == shell->mEvent.Zcl.addr) &&
				(light.GetZbEp() == shell->mEvent.Zcl.ep)) {
				LOG_INF("Device existed");
				return;
			}
		}
		for (auto &light : Lights)
		{
			if (!strcmp(light.GetName(), "none")) {
				AddDeviceEndpoint(&light, &bridgedLightEndpoint, DEVICE_TYPE_LO_ON_OFF_LIGHT);
				light.SetName("Light");
				light.SetZbAddr(shell->mEvent.Zdo.addr);
				light.SetZbEp(shell->mEvent.Zdo.ep);
				light.SetReachable(true);
				GetAppTask().PostEvent(AppEvent{ AppEvent::SimpleDescRsp, shell->mEvent.Zdo});
				break;
			}
		}
		break;
	case ZigbeeShell::kEvent_ZclAttrRead:
		for (auto &light : Lights)
		{
			if ((light.GetZbAddr() != shell->mEvent.Zcl.addr) ||
				(light.GetZbEp() != shell->mEvent.Zcl.ep)) {
				continue;
			}
			if (shell->mEvent.Zcl.cluster_id == ZigbeeShell::kCluster_OnOff &&
				shell->mEvent.Zcl.attr_id == ZigbeeShell::kOnOffAttr_OnOff &&
				shell->mEvent.Zcl.type == ZigbeeShell::kZclAttrType_BOOL) {
				if (!strncmp(shell->mEvent.Zcl.value, "True", shell->mEvent.Zcl.len)) {
					light.SetOnOff(true);
				} else if (!strncmp(shell->mEvent.Zcl.value, "False", shell->mEvent.Zcl.len)) {
					light.SetOnOff(false);
				} else {
					LOG_ERR("Wrong attr value");
				}
				break;
			}
		}
		break;
	default:
		LOG_WRN("Unknown event received");
		break;
	}

}

void AppTask::CancelFunctionTimer()
{
	k_timer_stop(&sFunctionTimer);
}

void AppTask::StartFunctionTimer(uint32_t timeoutInMs)
{
	k_timer_start(&sFunctionTimer, K_MSEC(timeoutInMs), K_NO_WAIT);
}

void AppTask::TimerEventHandler(k_timer *timer)
{
	GetAppTask().PostEvent(AppEvent{ AppEvent::FunctionTimer });
}
```

## src/app_task.h
```c
/*
 * Copyright (c) 2022 Nordic Semiconductor ASA
 *
 * SPDX-License-Identifier: LicenseRef-Nordic-5-Clause
 */

#pragma once

#include "app_event.h"
#include "led_widget.h"
#include "zigbee_shell.h"

#include <platform/CHIPDeviceLayer.h>

struct k_timer;

class AppTask {
public:
	int StartApp();

	void PostEvent(const AppEvent &aEvent);

private:
	int Init();

	void CancelFunctionTimer();
	void StartFunctionTimer(uint32_t timeoutInMs);

	void DispatchEvent(const AppEvent &event);
	void FunctionPressHandler();
	void FunctionReleaseHandler();
	void FunctionTimerEventHandler();

	static void UpdateStatusLED();
	static void LEDStateUpdateHandler(LEDWidget &ledWidget);
	static void ChipEventHandler(const chip::DeviceLayer::ChipDeviceEvent *event, intptr_t arg);
	static void ButtonEventHandler(uint32_t buttonState, uint32_t hasChanged);
	static void TimerEventHandler(k_timer *timer);
	static void ZigbeeEventHandler(ZigbeeShell * shell, ZigbeeShell::Event_t event);

	friend AppTask &GetAppTask();

	enum class TimerFunction { NoneSelected = 0, FactoryReset };

	TimerFunction mFunction = TimerFunction::NoneSelected;

	static AppTask sAppTask;
	bool mFunctionTimerActive = false;
};

inline AppTask &GetAppTask()
{
	return AppTask::sAppTask;
}
```

## src/chip_project_config.h
```c
/*
 * Copyright (c) 2022 Nordic Semiconductor ASA
 *
 * SPDX-License-Identifier: LicenseRef-Nordic-5-Clause
 */

/**
 *    @file
 *          Example project configuration file for CHIP.
 *
 *          This is a place to put application or project-specific overrides
 *          to the default configuration values for general CHIP features.
 *
 */

#pragma once

/**
 * CHIP_DEVICE_CONFIG_DEVICE_PRODUCT_ID
 *
 * 0x4E54: nrfconnect bridge
 */
#define CHIP_DEVICE_CONFIG_DEVICE_PRODUCT_ID 0x4E54

/* Use a default pairing code if one hasn't been provisioned in flash. */
#define CHIP_DEVICE_CONFIG_USE_TEST_SETUP_PIN_CODE 20202021
#define CHIP_DEVICE_CONFIG_USE_TEST_SETUP_DISCRIMINATOR 0xF00

// overrides CHIP_DEVICE_CONFIG_DYNAMIC_ENDPOINT_COUNT in CHIPProjectConfig
#define CHIP_DEVICE_CONFIG_DYNAMIC_ENDPOINT_COUNT 16
```

## src/zigbee_shell.cpp
```c
/*
 * Copyright (c) 2022 Nordic Semiconductor ASA
 *
 * SPDX-License-Identifier: LicenseRef-Nordic-5-Clause
 */

#include "zigbee_shell.h"
#include <logging/log.h>
#include <drivers/uart.h>

LOG_MODULE_DECLARE(zigbee_shell);

size_t ZigbeeShell::ShellRspHandler(ZigbeeShell *shell, const char *data, size_t len)
{
	char *p;

	p = strstr(data, ZB_SHELL_MSG_PROMPT);
	if (p != NULL) {
		LOG_DBG("Shell command finished");
		return p - data + strlen(ZB_SHELL_MSG_PROMPT);
	}

	return 0;
}

size_t ZigbeeShell::GeneralRspHandler(ZigbeeShell *shell, const char *data, size_t len)
{
	char *p;

	p = strstr((char *)data, ZB_SHELL_MSG_CMD_DONE);
	if (p != NULL) {
		LOG_DBG("General command finished - Done");
		shell->mZigbeeCmd.result = 0;
		return p - data + strlen(ZB_SHELL_MSG_CMD_DONE);
	}
	p = strstr((char *)data, ZB_SHELL_MSG_CMD_ERROR);
	if (p != NULL) {
		LOG_ERR("General command finished - Error");
		shell->mZigbeeCmd.result = -EINVAL;
		return p - data + strlen(ZB_SHELL_MSG_CMD_ERROR);
	}

	return 0;
}

size_t ZigbeeShell::ZclAttrReadRspHandler(ZigbeeShell *shell,const char *data, size_t len)
{
	char *p, *end;
	int attr_id;
	uint8_t type;
	size_t ret;

	p = strstr((char *)data, ZB_SHELL_MSG_CMD_ERROR);
	if (p != NULL) {
		LOG_ERR("Zcl attr read finished - Error");
		return p - data + strlen(ZB_SHELL_MSG_CMD_ERROR);
	}
	p = strstr((char *)data, ZB_SHELL_MSG_CMD_DONE);
	if (p == NULL) {
		LOG_DBG("Wait for more response");
		return 0;
	}
	ret = p - data + strlen(ZB_SHELL_MSG_CMD_DONE);
	p = strstr(data, "ID: ");
	if (p == NULL) {
		LOG_WRN("attr id missed");
		return ret;
	} else {
		p = p + strlen("ID: ");
		attr_id = strtol(p, &end, 10);
		if (p == end) {
			LOG_WRN("Can't get attr id");
			return ret;
		}
	}
	p = strstr(data, "Type: ");
	if (p == NULL) {
		LOG_WRN("attr type missed");
		return ret;
	} else {
		p = p + strlen("Type: ");
		type = strtol(p, &end, 16);
		if (p == end) {
			LOG_WRN("Can't get attr type");
			return ret;
		}
	}
	p = strstr(data, "Value: ");
	if (p == NULL) {
		LOG_WRN("Attr Value missed");
		return ret;
	}

	char *value_end = nullptr;

	p = p + strlen("Value: ");
	value_end = strstr(p, "\r\n");
	if (value_end == NULL) {
		LOG_WRN("Can't get attr value");
		return ret;
	}
	if ((value_end - p) > ZB_ZCL_MAX_ATTR_SIZE) {
		LOG_ERR("Fail to parse attr value");
		return 0;
	}
	memset(shell->mEvent.Zcl.value, 0, sizeof(shell->mEvent.Zcl.value));
	shell->mEvent.Zcl.len = value_end - p;
	shell->mEvent.Zcl.type = type;
	strncpy(shell->mEvent.Zcl.value, p, shell->mEvent.Zcl.len);
	LOG_INF("ID: %d Type: %x Value: %s", attr_id, type, shell->mEvent.Zcl.value);
	shell->mEvent_CB(shell, kEvent_ZclAttrRead);

	return ret;
}

size_t ZigbeeShell::ZdoActiveEpRspHandler(ZigbeeShell *shell, const char *data, size_t len)
{
	const char *p;
	uint16_t dev_addr;
	size_t ret;

	p = strstr((char *)data, ZB_SHELL_MSG_CMD_ERROR);
	if (p != NULL) {
		LOG_ERR("Zdo active endpoint request finished - Error");
		return p - data + strlen(ZB_SHELL_MSG_CMD_ERROR);
	}
	p = strstr((char *)data, ZB_SHELL_MSG_CMD_DONE);
	if (p == NULL) {
		LOG_DBG("Wait for more response");
		return 0;
	}
	ret = p - data + strlen(ZB_SHELL_MSG_CMD_DONE);
	p = data;
	for (;;) {
		p = strstr(p, "src_addr=");
		if (p == NULL) {
			break;
		} else {
			p = p + strlen("src_addr=");
			dev_addr = strtol(p, NULL, 16);
			p = strstr(p, "ep=");
			if (p == NULL) {
				break;
			} else {
				p = p + strlen("ep=");
				for (;;) {
					char *end;
					int ep;

					ep = strtol(p, &end, 10);
					if (p == end) {
						break;
					}
					shell->mEvent.Zdo.addr = dev_addr;
					shell->mEvent.Zdo.ep = ep;
					shell->mEvent_CB(shell, kEvent_ActiveEpRsp);
					if (*end == ',') {
						p = end + 1;
					} else {
						break;
					}
				}
			}
		}
	}
	return ret;
}

size_t ZigbeeShell::ZdoSimpleDescRspHandler(ZigbeeShell *shell, const char *data, size_t len)
{
	char *p;
	uint16_t dev_addr;
	size_t ret;

	p = strstr((char *)data, ZB_SHELL_MSG_CMD_ERROR);
	if (p != NULL) {
		LOG_ERR("Zdo simple descriptor request finished - Error");
		return p - data + strlen(ZB_SHELL_MSG_CMD_ERROR);
	}
	p = strstr((char *)data, ZB_SHELL_MSG_CMD_DONE);
	if (p == NULL) {
		LOG_DBG("Wait for more response");
		return 0;
	}
	ret = p - data + strlen(ZB_SHELL_MSG_CMD_DONE);
	p = strstr(data, "src_addr=");
	if (p == NULL) {
		return ret;
	} else {
		dev_addr = strtol(p + strlen("src_addr="), NULL, 16);
	}
	p = strstr(data, "ep=");
	if (p == NULL) {
		return ret;
	} else {
		char *end;
		int ep;
		int dev_id;

		p = p + strlen("ep=");
		ep = strtol(p, &end, 10);
		if (p != end) {
			p = strstr(data, "app_dev_id=");
			p = p + strlen("app_dev_id=");
			dev_id = strtol(p, &end, 16);
			if (p != end) {
				LOG_INF("addr: 0x%4hx, active ep: %d device id: %04hx",
					dev_addr, ep, dev_id);
				shell->mEvent.Zdo.addr = dev_addr;
				shell->mEvent.Zdo.ep = ep;
				shell->mEvent.Zdo.dev_id = dev_id;
				shell->mEvent_CB(shell, kEvent_SimpleDescRsp);
			}
		}
	}
	return ret;
}

void ZigbeeShell::UartWorkHandler(struct k_work *work)
{
	size_t ret = 0, parsed = 0, total_parsed = 0;

	ZigbeeShell *c = reinterpret_cast<ZigbeeShell*>((reinterpret_cast<char*>(work) - reinterpret_cast<int>((&(static_cast<ZigbeeShell*>(0)->mUartWork)))));
	if (c->mZigbeeCmd.handler == nullptr) {
		k_sem_give(&c->mCmdSem);
		return;
	}
	memset(c->mParserBuffer, 0, sizeof(c->mParserBuffer));
	ret = ring_buf_peek(&c->mShellRspRb, (uint8_t *)c->mParserBuffer, UNPARSED_BUF_LEN);
	if (ret == 0 || ret > UNPARSED_BUF_LEN) {
		LOG_ERR("Fail to peek ring buffer");
	}
	LOG_HEXDUMP_DBG(c->mParserBuffer, ret, "data to parse");
	parsed = c->mZigbeeCmd.handler(c, c->mParserBuffer, ret);
	if (parsed > 0) {
		k_sem_give(&c->mCmdSem);
	}
	total_parsed = (parsed > total_parsed) ? parsed : total_parsed;

	parsed = c->ParseShellMessage(c->mParserBuffer);
	total_parsed = (parsed > total_parsed) ? parsed : total_parsed;
	if (total_parsed > 0) {
		/* Remove parsed data from ring buffer */
		ret = ring_buf_get(&c->mShellRspRb, NULL, total_parsed);
		if(ret != total_parsed) {
			LOG_ERR("Fail to release from ring buffer");
		} else {
			LOG_INF("Release %d from buffer", ret);
		}
	}
}

int ZigbeeShell::WriteCmd(const char *cmd, ZigbeeResponseHandler rspHandler)
{
	int err = 0;
	size_t len;

	len = strlen(cmd);
	if (len + 2 > MAX_ZIGBEE_CMD_LEN) {
		LOG_INF("Not enough buffer to put Zigbee shell command");
		return -ENOMEM;
	}
	memset(mZigbeeCmd.command, 0, sizeof(mZigbeeCmd.command));
	memcpy(mZigbeeCmd.command, cmd, len);
	mZigbeeCmd.command[len] = '\r';
	mZigbeeCmd.command[len + 1] = '\n';
	mZigbeeCmd.handler = rspHandler;
	err = uart_tx(mUartDev, (const uint8_t *)mZigbeeCmd.command, strlen(mZigbeeCmd.command), 10);
	if (err) {
		LOG_ERR("uart_tx fail: %d", err);
	}
	k_sem_take(&mCmdSem, K_FOREVER);

	return mZigbeeCmd.result;
}

void ZigbeeShell::UartCallback(const struct device *dev, struct uart_event *evt, void *user_data)
{
	int err;
	static uint16_t pos;
	uint32_t ret;
	ZigbeeShell *shell = reinterpret_cast<ZigbeeShell *>(user_data);

	switch (evt->type) {
	case UART_TX_DONE:
		LOG_DBG("Tx sent %d bytes", evt->data.tx.len);
		break;

	case UART_TX_ABORTED:
		LOG_ERR("Tx aborted");
		break;

	case UART_RX_RDY:
		LOG_HEXDUMP_DBG(evt->data.rx.buf, evt->data.rx.len, "Uart RX");
		if (evt->data.rx.len > ring_buf_space_get(&shell->mShellRspRb)) {
			LOG_ERR("Not enough buffer to store data! Drop old data.");
			ret = ring_buf_get(&shell->mShellRspRb,
					   NULL,
					   evt->data.rx.len - ring_buf_space_get(&shell->mShellRspRb));
			LOG_ERR("Drop %d of ring buffer", ret);
		}
		/* Store received data to the ring buffer. */
		ret = ring_buf_put(&shell->mShellRspRb, evt->data.rx.buf + pos, evt->data.rx.len);
		if (ret != evt->data.rx.len) {
			LOG_ERR("Fail to put to ring buffer");
		}
		k_work_submit(&shell->mUartWork);
		pos += evt->data.rx.len;
		break;

	case UART_RX_BUF_REQUEST:
	{
		pos = 0;
		LOG_DBG("RX_REQUEST: %p", shell->mNextUartBuf);
		err = uart_rx_buf_rsp(shell->mUartDev,
				      shell->mNextUartBuf,
				      sizeof(shell->mUartRxBuf[0]));
		if (err) {
			LOG_WRN("UART RX buf rsp: %d", err);
		}
		break;
	}

	case UART_RX_BUF_RELEASED:
		LOG_DBG("RX_RELEASED: %p", evt->data.rx_buf.buf);
		shell->mNextUartBuf = evt->data.rx_buf.buf;
		break;

	case UART_RX_DISABLED:
		LOG_ERR("RX_DISABLED");
		break;

	case UART_RX_STOPPED:
		LOG_ERR("RX_STOPPED");
		break;
	}
}

size_t ZigbeeShell::ParseShellMessage(const char * szMsg)
{
	size_t parsed = 0, total_parsed = 0;
	char *p, *end;

	/* Parse network join message */
	p = strstr(szMsg, ZB_SHELL_MSG_JOIN_NETWORK);
	if (p != nullptr) {
		p = strstr(p, "Extended PAN ID: ");
		if (p != nullptr) {
			p = p + strlen("Extended PAN ID: ");
			memcpy(this->mEvent.Bdb.ext_pan_id, p, EXT_PAN_ID_SIZE);
			this->mEvent.Bdb.ext_pan_id[EXT_PAN_ID_SIZE] = 0;
			p = strstr(p, "PAN ID: ");
			if (p != nullptr) {
				p = p + strlen("PAN ID: ");
				this->mEvent.Bdb.pan_id = strtol(p, &end, 16);
				if (p != end) {
					LOG_INF("Joined network. Ext PAN ID: %s, PAN ID: 0x%04hx",
							this->mEvent.Bdb.ext_pan_id, this->mEvent.Bdb.pan_id);
					p = strstr(szMsg, ZB_SHELL_MSG_REJOIN);
					if (p != nullptr) {
						this->mEvent_CB(this, kEvent_NetworkRejoin);
					} else {
						this->mEvent_CB(this, kEvent_NetworkSteering);
					}
					parsed = end - szMsg;
				}
			}
		}
	}
	total_parsed = (parsed > total_parsed) ? parsed : total_parsed;
	/* Device annoucement message */
	p = strstr(szMsg, ZB_SHELL_MSG_DEVICE_REJOIN);
	if ((p != nullptr) && (p > szMsg)) {
		uint16_t dev_addr;

		parsed = p - mParserBuffer + strlen(ZB_SHELL_MSG_DEVICE_REJOIN) + strlen("xxxx)");
		dev_addr = strtol(p + strlen(ZB_SHELL_MSG_DEVICE_REJOIN), NULL, 16);
		LOG_INF("DEV announce: 0x%04hx", dev_addr);
		this->mEvent.Zdo.addr = dev_addr;
		this->mEvent_CB(this, kEvent_DeviceAnnounceRsp);
	}
	total_parsed = (parsed > total_parsed) ? parsed : total_parsed;
	LOG_DBG("%d bytes parsed", total_parsed);

	return total_parsed;
}

ZigbeeShell::ZigbeeShell(void)
{
	int err;

	k_work_init(&mUartWork, UartWorkHandler);
	k_sem_init(&mCmdSem, 0, 1);

	mUartDev = device_get_binding(CONFIG_ZIGBEE_SHELL_DEVICE_NAME);
	if (!mUartDev) {
		LOG_ERR("Failed to get the device");
	}
	err = uart_callback_set(mUartDev, UartCallback, this);
	if (err != 0) {
		LOG_ERR("Failed to set callback: %d", err);
	}
	mNextUartBuf = mUartRxBuf[1];
	err = uart_rx_enable(mUartDev, mUartRxBuf[0], UART_BUF_SIZE, 50000);
	if (err != 0) {
		LOG_ERR("Failed to enable RX: %d", err);
	}
	ring_buf_init(&mShellRspRb, sizeof(mShellRspBuffer), mShellRspBuffer);

	k_sleep(K_MSEC(10));

	err = WriteCmd("kernel reboot cold", nullptr);
	if (err) {
		LOG_ERR("Fail to reboot Zigbee shell");
	}

	k_sleep(K_MSEC(100));

	err = WriteCmd("shell colors off", ShellRspHandler);
	if (err) {
		LOG_ERR("Fail to shell color");
	}
	err = WriteCmd("shell echo off", ShellRspHandler);
	if (err) {
		LOG_ERR("Fail to set echo");
	}
}

int ZigbeeShell::BdbStart(void)
{
	int err = 0;

	err = WriteCmd("bdb role zc", GeneralRspHandler);
	if (err) {
		return err;
	}
	err = WriteCmd("bdb start", GeneralRspHandler);
	if (err) {
		return err;
	}
	err = WriteCmd("bdb legacy enable", GeneralRspHandler);
	if (err) {
		return err;
	}

	return err;
}

int ZigbeeShell::NetworkSteering(void)
{
	return WriteCmd("bdb start", GeneralRspHandler);
}

int ZigbeeShell::ZdoActiveEpReq(uint16_t addr)
{
	int err = 0;
	char cmd[MAX_ZIGBEE_CMD_LEN];

	LOG_INF("Request active endpoint of addr: 0x%04hx", addr);
	sprintf(cmd, "zdo active_ep 0x%04hx", addr);
	err = WriteCmd(cmd, ZdoActiveEpRspHandler);

	return err;
}

int ZigbeeShell::ZdoSimpleDescReq(uint16_t addr, uint8_t ep)
{
	int err = 0;
	char cmd[MAX_ZIGBEE_CMD_LEN];

	LOG_INF("Request simple descriptor of addr: 0x%04hx ep: %d ", addr, ep);
	sprintf(cmd, "zdo simple_desc_req 0x%04hx %d", addr, ep);
	err = WriteCmd(cmd, ZdoSimpleDescRspHandler);

	return err;
}

int ZigbeeShell::ZclCmd(uint16_t addr, uint8_t ep, uint16_t cluster, uint16_t cmd_id)
{
	int err = 0;
	char cmd[MAX_ZIGBEE_CMD_LEN];

	LOG_INF("Send ZCL cmd. addr: 0x%04hx ep: %d cluster: 0x%04hx cmd_id: 0x%04hx", addr, ep, cluster, cmd_id);
	sprintf(cmd, "zcl cmd -d 0x%04hx %d 0x%04hx 0x%04hx", addr, ep, cluster, cmd_id);
	err = WriteCmd(cmd, GeneralRspHandler);

	return err;
}

int ZigbeeShell::ZclAttrRead(uint16_t addr,
			     uint8_t ep,
			     uint16_t profile_id,
			     enum Cluster_t cluster_id,
			     uint16_t attr_id)
{
	int err = 0;
	char cmd[MAX_ZIGBEE_CMD_LEN];

	LOG_INF("Read ZCL attr addr: 0x%04hx ep: %d cluster: 0x%04hx attr_id: 0x%04hx", addr, ep, cluster_id, attr_id);
	sprintf(cmd, "zcl attr read 0x%04hx %d 0x%04hx 0x%04hx 0x%04hx", addr, ep, cluster_id, profile_id, attr_id);
	mEvent.Zcl.addr = addr;
	mEvent.Zcl.ep = ep;
	mEvent.Zcl.cluster_id = cluster_id;
	mEvent.Zcl.attr_id = attr_id;
	err = WriteCmd(cmd, ZclAttrReadRspHandler);

	return err;
}

int ZigbeeShell::ZdoMatchDesc(uint16_t dst_addr,
			      uint16_t req_addr,
			      uint16_t profile_id,
			      uint8_t in_cluster_cnt,
			      uint16_t *in_clusters,
			      uint8_t out_cluster_cnt,
			      uint16_t *out_clusters)
{
	int err = 0;
	char cmd[MAX_ZIGBEE_CMD_LEN], in_cluster_str[32], out_cluster_str[32];

	memset(cmd, 0, sizeof(cmd));
	memset(in_cluster_str, 0, sizeof(in_cluster_str));
	memset(out_cluster_str, 0, sizeof(out_cluster_str));
	for (auto i = 0; i < in_cluster_cnt; i++) {
		sprintf(in_cluster_str + 2*i, "%hx ", *(in_clusters + 2*i));
	}
	for (auto i = 0; i < out_cluster_cnt; i++) {
		sprintf(out_cluster_str + 2*i, "%hx ", *(out_clusters + 2*i));
	}
	sprintf(cmd, "zdo match_desc 0x%04hx 0x%04hx 0x%04hx %d %s %d %s -t 5",
		dst_addr, req_addr, profile_id, in_cluster_cnt, in_cluster_str, out_cluster_cnt, out_cluster_str);
	err = WriteCmd(cmd, ZdoActiveEpRspHandler);

	return err;
}

void ZigbeeShell::SetEventCallback(zigbee_event_handler_t zigbee_event_handler)
{
	mEvent_CB = zigbee_event_handler;
}
```
