## CMakeLists.txt
```
#
# Copyright (c) 2021 Nordic Semiconductor ASA
#
# SPDX-License-Identifier: LicenseRef-Nordic-5-Clause
#

cmake_minimum_required(VERSION 3.20.0)

# Set Kconfig root files that will be processed as a first Kconfig for used child images.
set(mcuboot_KCONFIG_ROOT "\\\${ZEPHYR_CONNECTEDHOMEIP_MODULE_DIR}/config/nrfconnect/chip-module/Kconfig.mcuboot.root")
set(multiprotocol_rpmsg_KCONFIG_ROOT "\\\${ZEPHYR_CONNECTEDHOMEIP_MODULE_DIR}/config/nrfconnect/chip-module/Kconfig.multiprotocol_rpmsg.root")
set(hci_rpmsg_KCONFIG_ROOT "\\\${ZEPHYR_CONNECTEDHOMEIP_MODULE_DIR}/config/nrfconnect/chip-module/Kconfig.hci_rpmsg.root")

# For prj.conf the CONF_FILE is empty. In other case extract the exact file name from the path string.
if(CONF_FILE)
    get_filename_component(CONFIG_FILE_NAME ${CONF_FILE} NAME)
endif()

if("${CONFIG_FILE_NAME}" STREQUAL "prj_thread_wifi_switched.conf")
    set(PM_STATIC_YML_FILE ${CMAKE_CURRENT_SOURCE_DIR}/configuration/${BOARD}/pm_static_thread_wifi_switched.yml)
elseif(NOT "${CONFIG_FILE_NAME}" STREQUAL "prj_no_dfu.conf")
    set(PM_STATIC_YML_FILE ${CMAKE_CURRENT_SOURCE_DIR}/configuration/${BOARD}/pm_static_dfu.yml)
endif()

find_package(Zephyr HINTS $ENV{ZEPHYR_BASE})

project(matter-lock)

set(COMMON_ROOT ${ZEPHYR_NRF_MODULE_DIR}/samples/matter/common)
set(NLIO_ROOT ${ZEPHYR_CONNECTEDHOMEIP_MODULE_DIR}/third_party/nlio/repo)
include(${ZEPHYR_CONNECTEDHOMEIP_MODULE_DIR}/config/nrfconnect/app/enable-gnu-std.cmake)
include(${ZEPHYR_CONNECTEDHOMEIP_MODULE_DIR}/src/app/chip_data_model.cmake)

# NORDIC SDK APP START
target_include_directories(app PRIVATE
    src
    ${COMMON_ROOT}/src
    ${COMMON_ROOT}/src/persistent_storage/
    ${NLIO_ROOT}/include
    ${ZEPHYR_CONNECTEDHOMEIP_MODULE_DIR}/zzz_generated/app-common
)

SET(access_srcs src/access/access_data_types.cpp
              src/access/access_manager_credentials.cpp
              src/access/access_manager_users.cpp
              src/access/access_manager.cpp
              src/access/access_storage.cpp
              )

if(CONFIG_LOCK_SCHEDULES)
    LIST(APPEND access_srcs src/access/access_manager_schedules.cpp)
endif()

target_sources(app PRIVATE
    src/app_task.cpp
    src/bolt_lock_manager.cpp
    src/main.cpp
    src/zcl_callbacks.cpp
    src/zap-generated/callback-stub.cpp
    src/zap-generated/IMClusterCommandHandler.cpp
    ${COMMON_ROOT}/src/led_widget.cpp
    ${access_srcs}
)

zephyr_library_sources_ifdef(
	CONFIG_MATTER_LOCK_SHELL
	src/matter_lock_shell.cpp
)

if(CONFIG_CHIP_OTA_REQUESTOR OR CONFIG_MCUMGR_TRANSPORT_BT)
    target_sources(app PRIVATE ${COMMON_ROOT}/src/ota_util.cpp)
endif()

if(CONFIG_CHIP_NUS)
    target_sources(app PRIVATE ${COMMON_ROOT}/src/bt_nus_service.cpp)
endif()

if(CONFIG_MCUMGR_TRANSPORT_BT)
    zephyr_library_link_libraries(MCUBOOT_BOOTUTIL)
    target_sources(app PRIVATE ${COMMON_ROOT}/src/dfu_over_smp.cpp)
endif()

if(CONFIG_THREAD_WIFI_SWITCHING)
    target_sources(app PRIVATE
        src/software_images_swapper.cpp
        ${COMMON_ROOT}/src/ota_multi_image_processor_impl.cpp
        ${COMMON_ROOT}/src/ota_multi_image_downloader.cpp
    )
endif()

if(CONFIG_CHIP_ICD_SUBSCRIPTION_HANDLING)
    target_sources(app PRIVATE ${COMMON_ROOT}/src/icd_util.cpp)
endif()

if(CONFIG_NCS_SAMPLE_MATTER_PERSISTENT_STORAGE)
    target_sources_ifdef(CONFIG_NCS_SAMPLE_MATTER_SETTINGS_STORAGE_BACKEND app PRIVATE
            ${COMMON_ROOT}/src/persistent_storage/backends/persistent_storage_settings.cpp)
    target_sources_ifdef(CONFIG_NCS_SAMPLE_MATTER_SECURE_STORAGE_BACKEND app PRIVATE
            ${COMMON_ROOT}/src/persistent_storage/backends/persistent_storage_secure.cpp)
endif()

chip_configure_data_model(app
    INCLUDE_SERVER
    BYPASS_IDL
    GEN_DIR src/zap-generated
    ZAP_FILE ${CMAKE_CURRENT_SOURCE_DIR}/src/lock.zap
)

if(CONFIG_THREAD_WIFI_SWITCHING)
    find_package(Python3)
    set(app_idx ${CONFIG_APPLICATION_IDX})
    add_custom_target(flash-external
        COMMAND ${Python3_EXECUTABLE} ${CMAKE_CURRENT_SOURCE_DIR}/src/flash-external.py
            --app ${APPLICATION_BINARY_DIR}/zephyr/app_update.bin
            --app-offset ${PM_APP_${app_idx}_CORE_APP_OFFSET}
            --app-size ${PM_APP_${app_idx}_CORE_APP_SIZE}
            --net ${APPLICATION_BINARY_DIR}/zephyr/net_core_app_update.bin
            --net-offset ${PM_APP_${app_idx}_CORE_NET_OFFSET}
            --net-size ${PM_APP_${app_idx}_CORE_NET_SIZE}
        USES_TERMINAL
        DEPENDS
            ${APPLICATION_BINARY_DIR}/zephyr/app_update.bin
            ${APPLICATION_BINARY_DIR}/zephyr/net_core_app_update.bin
    )
endif()
# NORDIC SDK APP END
```

## Kconfig
```
#
# Copyright (c) 2021 Nordic Semiconductor
#
# SPDX-License-Identifier: LicenseRef-Nordic-5-Clause
#

mainmenu "Matter Lock sample application"

config LOCK_NUM_USERS
	int "Maximum number of users supported by lock"
	default 10

config LOCK_NUM_CREDENTIALS
	int "Maximum number of credentials supported by lock"
	default 20

config LOCK_NUM_CREDENTIALS_PER_USER
	int "Maximum number of credentials per user supported by lock"
	default 3

config STATE_LEDS
	bool "Use LEDs to indicate the device state"
	default y
	help
	  Use LEDs to render the current state of the device such as the progress of commissioning of
	  the device into a network or the factory reset initiation. Note that setting this option to
	  'n' does not disable the LED indicating the state of the simulated bolt.

config THREAD_WIFI_SWITCHING
	bool "Switching between Thread and Wi-Fi network support"
	depends on SOC_SERIES_NRF53X
	depends on NET_L2_OPENTHREAD || CHIP_WIFI
	depends on CHIP_OTA_REQUESTOR
	select EXPERIMENTAL
	help
	  Enable the functionality that allows a user to switch between Matter over Thread and Matter
	  over Wi-Fi variants of the application, stored in the respective partitions in the external
	  flash memory.

if THREAD_WIFI_SWITCHING

config APPLICATION_IDX
	int
	default 1 if NET_L2_OPENTHREAD
	default 2 if CHIP_WIFI

config APPLICATION_OTHER_IDX
	int
	default 2 if NET_L2_OPENTHREAD
	default 1 if CHIP_WIFI

config APPLICATION_LABEL
	string
	default "Thread" if NET_L2_OPENTHREAD
	default "Wi-Fi" if CHIP_WIFI

config APPLICATION_OTHER_LABEL
	string
	default "Wi-Fi" if NET_L2_OPENTHREAD
	default "Thread" if CHIP_WIFI

config THREAD_WIFI_SWITCHING_CLI_SUPPORT
	bool "Add CLI command for triggering of the switch between Thread and Wi-Fi"
	default n
	select CHIP_LIB_SHELL

# We need more heap size for image swap buffers
config CHIP_MALLOC_SYS_HEAP_SIZE
	default 30720 if CHIP_WIFI
	default 10240 if NET_L2_OPENTHREAD

endif

# Sample configuration used for Thread networking
if NET_L2_OPENTHREAD

choice OPENTHREAD_NORDIC_LIBRARY_CONFIGURATION
	default OPENTHREAD_NORDIC_LIBRARY_MTD
endchoice

choice OPENTHREAD_DEVICE_TYPE
	default OPENTHREAD_MTD
endchoice

config CHIP_ENABLE_SLEEPY_END_DEVICE_SUPPORT
	default y

# Reduce Thread TX output power to 0 dBm for SED device
config OPENTHREAD_DEFAULT_TX_POWER
	int
	default 0

endif # NET_L2_OPENTHREAD

if CHIP_WIFI

config NRF_WIFI_LOW_POWER
	default y

endif # CHIP_WIFI

config CHIP_ICD_SUBSCRIPTION_HANDLING
	default y

config CHIP_MAX_ALLOWED_SUBSCRIPTION_REPORT_INTERVAL
	int
	default 60

source "${ZEPHYR_CONNECTEDHOMEIP_MODULE_DIR}/config/nrfconnect/chip-module/Kconfig.features"
source "${ZEPHYR_CONNECTEDHOMEIP_MODULE_DIR}/config/nrfconnect/chip-module/Kconfig.defaults"
source "Kconfig.zephyr"
```

## prj.conf
```kconfig
#
# Copyright (c) 2022 Nordic Semiconductor ASA
#
# SPDX-License-Identifier: LicenseRef-Nordic-5-Clause
#

# This sample uses Kconfig.defaults to set options common for all
# samples. This file should contain only options specific for this sample
# or overrides of default values.

# Enable CHIP
CONFIG_CHIP=y
CONFIG_CHIP_PROJECT_CONFIG="src/chip_project_config.h"
# 32774 == 0x8006 (example lock-app)
CONFIG_CHIP_DEVICE_PRODUCT_ID=32774
CONFIG_STD_CPP14=y

# Add support for LEDs and buttons on Nordic development kits
CONFIG_DK_LIBRARY=y

# Bluetooth Low Energy configuration
CONFIG_BT_DEVICE_NAME="MatterLock"

# Suspend devices when the CPU goes into sleep
CONFIG_PM_DEVICE=y

# Other settings
CONFIG_THREAD_NAME=y
CONFIG_MPU_STACK_GUARD=y
CONFIG_RESET_ON_FATAL_ERROR=n
CONFIG_CHIP_LIB_SHELL=y

# Reduce application size
CONFIG_USE_SEGGER_RTT=n

# Enable Factory Data feature
CONFIG_CHIP_FACTORY_DATA=y
CONFIG_CHIP_FACTORY_DATA_BUILD=y

CONFIG_CHIP_PERSISTENT_SUBSCRIPTIONS=y
```

## src/bolt_lock_manager.cpp
```c
/*
 * Copyright (c) 2021 Nordic Semiconductor ASA
 *
 * SPDX-License-Identifier: LicenseRef-Nordic-5-Clause
 */

#include "bolt_lock_manager.h"

#include "app_event.h"
#include "app_task.h"

using namespace chip;

BoltLockManager BoltLockManager::sLock;

void BoltLockManager::Init(StateChangeCallback callback)
{
	mStateChangeCallback = callback;

	k_timer_init(&mActuatorTimer, &BoltLockManager::ActuatorTimerEventHandler, nullptr);
	k_timer_user_data_set(&mActuatorTimer, this);

	AccessMgr::Instance().Init();
}

bool BoltLockManager::GetUser(uint16_t userIndex, EmberAfPluginDoorLockUserInfo &user)
{
	return AccessMgr::Instance().GetUserInfo(userIndex, user);
}

bool BoltLockManager::SetUser(uint16_t userIndex, FabricIndex creator, FabricIndex modifier, const CharSpan &userName,
			      uint32_t uniqueId, UserStatusEnum userStatus, UserTypeEnum userType,
			      CredentialRuleEnum credentialRule, const CredentialStruct *credentials,
			      size_t totalCredentials)
{
	return AccessMgr::Instance().SetUser(userIndex, creator, modifier, userName, uniqueId, userStatus, userType,
					      credentialRule, credentials, totalCredentials);
}

bool BoltLockManager::GetCredential(uint16_t credentialIndex, CredentialTypeEnum credentialType,
				    EmberAfPluginDoorLockCredentialInfo &credential)
{
	return AccessMgr::Instance().GetCredential(credentialIndex, credentialType, credential);
}

bool BoltLockManager::SetCredential(uint16_t credentialIndex, FabricIndex creator, FabricIndex modifier,
				    DlCredentialStatus credentialStatus, CredentialTypeEnum credentialType,
				    const ByteSpan &secret)
{
	return AccessMgr::Instance().SetCredential(credentialIndex, creator, modifier, credentialStatus,
						    credentialType, secret);
}

bool BoltLockManager::ClearAllUserCredential()
{
	bool ret;
	CredentialStruct credential{ (CredentialTypeEnum)0, 0 };

	for (size_t idxUsr = 0; idxUsr < CONFIG_LOCK_MAX_NUM_USERS; ++idxUsr) {
		ret = AccessMgr::Instance().SetUser(idxUsr + 1, 0, 0, chip::CharSpan(), 0, UserStatusEnum::kAvailable, UserTypeEnum::kUnrestrictedUser,
											CredentialRuleEnum::kSingle, &credential, 0);
		if (!ret) {
			return false;
		}
	}
	for (size_t idxCred = 0; idxCred < CONFIG_LOCK_MAX_NUM_CREDENTIALS_PER_TYPE; ++idxCred) {
		ret = AccessMgr::Instance().SetCredential(idxCred + 1, 0, 0, DlCredentialStatus::kAvailable,
												  CredentialTypeEnum::kPin, chip::ByteSpan());
		if (!ret) {
			return false;
		}
	}

	return true;
}

#ifdef CONFIG_LOCK_SCHEDULES

DlStatus BoltLockManager::GetWeekDaySchedule(uint8_t weekdayIndex, uint16_t userIndex,
					     EmberAfPluginDoorLockWeekDaySchedule &schedule)
{
	return AccessMgr::Instance().GetWeekDaySchedule(weekdayIndex, userIndex, schedule);
}

DlStatus BoltLockManager::SetWeekDaySchedule(uint8_t weekdayIndex, uint16_t userIndex, DlScheduleStatus status,
					     DaysMaskMap daysMask, uint8_t startHour, uint8_t startMinute,
					     uint8_t endHour, uint8_t endMinute)
{
	return AccessMgr::Instance().SetWeekDaySchedule(weekdayIndex, userIndex, status, daysMask, startHour,
							 startMinute, endHour, endMinute);
}

DlStatus BoltLockManager::GetYearDaySchedule(uint8_t yearDayIndex, uint16_t userIndex,
					     EmberAfPluginDoorLockYearDaySchedule &schedule)
{
	return AccessMgr::Instance().GetYearDaySchedule(yearDayIndex, userIndex, schedule);
}

DlStatus BoltLockManager::SetYearDaySchedule(uint8_t yeardayIndex, uint16_t userIndex, DlScheduleStatus status,
					     uint32_t localStartTime, uint32_t localEndTime)
{
	return AccessMgr::Instance().SetYearDaySchedule(yeardayIndex, userIndex, status, localStartTime, localEndTime);
}

DlStatus BoltLockManager::GetHolidaySchedule(uint8_t holidayIndex, EmberAfPluginDoorLockHolidaySchedule &schedule)
{
	return AccessMgr::Instance().GetHolidaySchedule(holidayIndex, schedule);
}

DlStatus BoltLockManager::SetHolidaySchedule(uint8_t holidayIndex, DlScheduleStatus status, uint32_t localStartTime,
					     uint32_t localEndTime, OperatingModeEnum operatingMode)
{
	return AccessMgr::Instance().SetHolidaySchedule(holidayIndex, status, localStartTime, localEndTime,
							 operatingMode);
}

#endif /* CONFIG_LOCK_SCHEDULES */


bool BoltLockManager::ValidatePIN(const Optional<ByteSpan> &pinCode, OperationErrorEnum &err)
{
	return AccessMgr::Instance().ValidatePIN(pinCode, err);
}

void BoltLockManager::SetRequirePIN(bool require)
{
	return AccessMgr::Instance().SetRequirePIN(require);
}
bool BoltLockManager::GetRequirePIN()
{
	return AccessMgr::Instance().GetRequirePIN();
}

#ifdef CONFIG_LOCK_ENABLE_DEBUG
bool BoltLockManager::PrintUserdata(uint8_t userIndex)
{
	/* userIndex is guaranteed by the caller to be between 1 and CONFIG_LOCK_MAX_NUM_USERS */
	VerifyOrReturnError(userIndex > 0 && userIndex <= CONFIG_LOCK_MAX_NUM_USERS, false);
	AccessMgr::Instance().PrintUser(userIndex);
	return true;
}

bool BoltLockManager::PrintCredential(CredentialTypeEnum type, uint16_t credentialIndex)
{
	/* credentialIndex is guaranteed by the caller to be between 1 and CONFIG_LOCK_MAX_NUM_CREDENTIALS_PER_TYPE */
	VerifyOrReturnError(credentialIndex > 0 && credentialIndex <= CONFIG_LOCK_MAX_NUM_CREDENTIALS_PER_TYPE, false);
	AccessMgr::Instance().PrintCredential(type, credentialIndex);
	return true;
}
#endif//CONFIG_LOCK_ENABLE_DEBUG

void BoltLockManager::Lock(OperationSource source)
{
	VerifyOrReturn(mState != State::kLockingCompleted);
	SetState(State::kLockingInitiated, source);

	mActuatorOperationSource = source;
	k_timer_start(&mActuatorTimer, K_MSEC(kActuatorMovementTimeMs), K_NO_WAIT);
}

void BoltLockManager::Unlock(OperationSource source)
{
	VerifyOrReturn(mState != State::kUnlockingCompleted);
	SetState(State::kUnlockingInitiated, source);

	mActuatorOperationSource = source;
	k_timer_start(&mActuatorTimer, K_MSEC(kActuatorMovementTimeMs), K_NO_WAIT);
}

void BoltLockManager::ActuatorTimerEventHandler(k_timer *timer)
{
	/*
	 * The timer event handler is called in the context of the system clock ISR.
	 * Post an event to the application task queue to process the event in the
	 * context of the application thread.
	 */

	AppEvent event;
	event.Type = AppEventType::Timer;
	event.TimerEvent.Context = static_cast<BoltLockManager *>(k_timer_user_data_get(timer));
	event.Handler = BoltLockManager::ActuatorAppEventHandler;
	AppTask::Instance().PostEvent(event);
}

void BoltLockManager::ActuatorAppEventHandler(const AppEvent &event)
{
	BoltLockManager *lock = static_cast<BoltLockManager *>(event.TimerEvent.Context);

	if (!lock) {
		return;
	}

	switch (lock->mState) {
	case State::kLockingInitiated:
		lock->SetState(State::kLockingCompleted, lock->mActuatorOperationSource);
		break;
	case State::kUnlockingInitiated:
		lock->SetState(State::kUnlockingCompleted, lock->mActuatorOperationSource);
		break;
	default:
		break;
	}
}

void BoltLockManager::SetState(State state, OperationSource source)
{
	mState = state;

	if (mStateChangeCallback != nullptr) {
		mStateChangeCallback(state, source);
	}
}
```

## src/bolt_lock_manager.h
```c
/*
 * Copyright (c) 2021 Nordic Semiconductor ASA
 *
 * SPDX-License-Identifier: LicenseRef-Nordic-5-Clause
 */

#pragma once

#include "access/access_manager.h"

#include <app/clusters/door-lock-server/door-lock-server.h>
#include <lib/core/ClusterEnums.h>

#include <zephyr/kernel.h>

#include <cstdint>

class AppEvent;

class BoltLockManager {
public:
	static constexpr size_t kMaxCredentialLength = 128;

	enum class State : uint8_t {
		kLockingInitiated = 0,
		kLockingCompleted,
		kUnlockingInitiated,
		kUnlockingCompleted,
	};

	struct UserData {
		char mName[DOOR_LOCK_USER_NAME_BUFFER_SIZE];
		CredentialStruct mCredentials[CONFIG_LOCK_MAX_NUM_CREDENTIALS_PER_USER];
	};

	struct CredentialData {
		chip::Platform::ScopedMemoryBuffer<uint8_t> mSecret;
	};

	using OperationSource = chip::app::Clusters::DoorLock::OperationSourceEnum;
	using StateChangeCallback = void (*)(State, OperationSource);

	static constexpr uint32_t kActuatorMovementTimeMs = 2000;

	void Init(StateChangeCallback callback);

	State GetState() const { return mState; }
	bool IsLocked() const { return mState == State::kLockingCompleted; }

	bool GetUser(uint16_t userIndex, EmberAfPluginDoorLockUserInfo &user);
	bool SetUser(uint16_t userIndex, chip::FabricIndex creator, chip::FabricIndex modifier,
		     const chip::CharSpan &userName, uint32_t uniqueId, UserStatusEnum userStatus,
		     UserTypeEnum userType, CredentialRuleEnum credentialRule, const CredentialStruct *credentials,
		     size_t totalCredentials);

	bool GetCredential(uint16_t credentialIndex, CredentialTypeEnum credentialType,
			   EmberAfPluginDoorLockCredentialInfo &credential);
	bool SetCredential(uint16_t credentialIndex, chip::FabricIndex creator, chip::FabricIndex modifier,
			   DlCredentialStatus credentialStatus, CredentialTypeEnum credentialType,
			   const chip::ByteSpan &secret);
	bool ClearAllUserCredential();

#ifdef CONFIG_LOCK_SCHEDULES
	DlStatus GetWeekDaySchedule(uint8_t weekdayIndex, uint16_t userIndex,
				    EmberAfPluginDoorLockWeekDaySchedule &schedule);
	DlStatus SetWeekDaySchedule(uint8_t weekdayIndex, uint16_t userIndex, DlScheduleStatus status,
				    DaysMaskMap daysMask, uint8_t startHour, uint8_t startMinute, uint8_t endHour,
				    uint8_t endMinute);
	DlStatus GetYearDaySchedule(uint8_t yearDayIndex, uint16_t userIndex,
				    EmberAfPluginDoorLockYearDaySchedule &schedule);
	DlStatus SetYearDaySchedule(uint8_t yearDayIndex, uint16_t userIndex, DlScheduleStatus status,
				    uint32_t localStartTime, uint32_t localEndTime);
	DlStatus GetHolidaySchedule(uint8_t holidayIndex, EmberAfPluginDoorLockHolidaySchedule &schedule);
	DlStatus SetHolidaySchedule(uint8_t holidayIndex, DlScheduleStatus status, uint32_t localStartTime,
				    uint32_t localEndTime, OperatingModeEnum operatingMode);
#endif /* CONFIG_LOCK_SCHEDULES */

	bool ValidatePIN(const Optional<chip::ByteSpan> &pinCode, OperationErrorEnum &err);

	void Lock(OperationSource source);
	void Unlock(OperationSource source);

	void SetRequirePIN(bool require);
	bool GetRequirePIN();

#ifdef CONFIG_LOCK_ENABLE_DEBUG
	bool PrintUserdata(uint8_t userIndex);
	bool PrintCredential(CredentialTypeEnum type, uint16_t index);
#endif

private:
	using AccessMgr = AccessManager<DoorLockData::PIN>;
	friend class AppTask;

	void SetState(State state, OperationSource source);

	static void ActuatorTimerEventHandler(k_timer *timer);
	static void ActuatorAppEventHandler(const AppEvent &aEvent);
	friend BoltLockManager &BoltLockMgr();

	State mState = State::kLockingCompleted;
	StateChangeCallback mStateChangeCallback = nullptr;
	OperationSource mActuatorOperationSource = OperationSource::kButton;
	k_timer mActuatorTimer = {};

	static BoltLockManager sLock;
};

inline BoltLockManager &BoltLockMgr()
{
	return BoltLockManager::sLock;
}
```

## src/lock_storage_manager.cpp
```c
#include "lock_storage_manager.h"
#include "persistent_storage/persistent_storage_util.h"

namespace
{
template <class T> bool LoadDataToObject(Nrf::PersistentStorageNode *node, T &data)
{
	size_t readSize = 0;

	bool result =Nrf::PersistentStorage::Instance().Load(node, &data, sizeof(T), readSize);

	return result;
}

Nrf::PersistentStorageNode CreateIndexNode(uint8_t nodeIndex, Nrf::PersistentStorageNode *parent)
{
	char index[Nrf::LockStorageManager::kMaxIndexLength + 1] = { 0 };

	snprintf(index, sizeof(index), "%d", nodeIndex);

	return Nrf::PersistentStorageNode(index, strlen(index), parent);
}

} /* namespace */

namespace Nrf {
bool LockStorageManager::StoreUsersCount(uint8_t count)
{
	return Nrf::PersistentStorage::Instance().Store(&mUsersCount, &count, sizeof(count));
}

bool LockStorageManager::LoadUsersCount(uint8_t &count)
{
	return LoadDataToObject(&mUsersCount, count);
}

bool LockStorageManager::StoreUserData(BoltLockManager::UserData userData, uint8_t index)
{
	Nrf::PersistentStorageNode id = CreateIndexNode(index, &mUserData);

	return Nrf::PersistentStorage::Instance().Store(&id, &userData, sizeof(userData));
}

bool LockStorageManager::LoadUserData(BoltLockManager::UserData &userData, uint8_t index)
{
	Nrf::PersistentStorageNode id = CreateIndexNode(index, &mUserData);

	return LoadDataToObject(&id, userData);
}

bool LockStorageManager::StoreUserUniqueID(uint32_t userUniqueId, uint8_t index)
{
	Nrf::PersistentStorageNode id = CreateIndexNode(index, &mUserUniqueId);

	return Nrf::PersistentStorage::Instance().Store(&id, &userUniqueId, sizeof(userUniqueId));
}

bool LockStorageManager::LoadUserUniqueID(uint32_t &userUniqueID, uint8_t index)
{
	Nrf::PersistentStorageNode id = CreateIndexNode(index, &mUserUniqueId);

	return LoadDataToObject(&id, userUniqueID);
}

bool LockStorageManager::StoreUserStatus(UserStatusEnum userStatus, uint8_t index)
{
	Nrf::PersistentStorageNode id = CreateIndexNode(index, &mUserStatus);

	return Nrf::PersistentStorage::Instance().Store(&id, &userStatus, sizeof(userStatus));
}

bool LockStorageManager::LoadUserStatus(UserStatusEnum &userStatus, uint8_t index)
{
	Nrf::PersistentStorageNode id = CreateIndexNode(index, &mUserStatus);

	return LoadDataToObject(&id, userStatus);
}

bool LockStorageManager::StoreUserType(UserTypeEnum userType, uint8_t index)
{
	Nrf::PersistentStorageNode id = CreateIndexNode(index, &mUserType);

	return Nrf::PersistentStorage::Instance().Store(&id, &userType, sizeof(userType));
}

bool LockStorageManager::LoadUserType(UserTypeEnum &userType, uint8_t index)
{
	Nrf::PersistentStorageNode id = CreateIndexNode(index, &mUserType);

	return LoadDataToObject(&id, userType);
}

bool LockStorageManager::StoreUserCreatedBy(uint8_t createdBy, uint8_t index)
{
	Nrf::PersistentStorageNode id = CreateIndexNode(index, &mUserCreateBy);

	return Nrf::PersistentStorage::Instance().Store(&id, &createdBy, sizeof(createdBy));
}

bool LockStorageManager::LoadUserCreatedBy(uint8_t &createdBy, uint8_t index)
{
	Nrf::PersistentStorageNode id = CreateIndexNode(index, &mUserCreateBy);

	return LoadDataToObject(&id, createdBy);
}

bool LockStorageManager::StoreUserLastModifiedBy(uint8_t lastModifiedBy, uint8_t index)
{
	Nrf::PersistentStorageNode id = CreateIndexNode(index, &mUserLastModifiedBy);

	return Nrf::PersistentStorage::Instance().Store(&id, &lastModifiedBy, sizeof(lastModifiedBy));
}

bool LockStorageManager::LoadUserLastModifiedBy(uint8_t &lastModifiedBy, uint8_t index)
{
	Nrf::PersistentStorageNode id = CreateIndexNode(index, &mUserLastModifiedBy);

	return LoadDataToObject(&id, lastModifiedBy);
}

bool LockStorageManager::StoreUserCredentialRule(CredentialRuleEnum credentialRule, uint8_t index)
{
	Nrf::PersistentStorageNode id = CreateIndexNode(index, &mUserCredentialRule);

	return Nrf::PersistentStorage::Instance().Store(&id, &credentialRule, sizeof(credentialRule));
}

bool LockStorageManager::LoadUserCredentialRule(CredentialRuleEnum &credentialRule, uint8_t index)
{
	Nrf::PersistentStorageNode id = CreateIndexNode(index, &mUserCredentialRule);

	return LoadDataToObject(&id, credentialRule);
}

bool LockStorageManager::StoreCredentialsCount(uint8_t count)
{
	return Nrf::PersistentStorage::Instance().Store(&mCredentialsCount, &count, sizeof(count));
}

bool LockStorageManager::LoadCredentialsCount(uint8_t &count)
{
	return LoadDataToObject(&mCredentialsCount, count);
}

bool LockStorageManager::StoreCredentialStatus(DlCredentialStatus credentialStatus, uint8_t index)
{
	Nrf::PersistentStorageNode id = CreateIndexNode(index, &mCredentialStatus);

	return Nrf::PersistentStorage::Instance().Store(&id, &credentialStatus, sizeof(credentialStatus));
}

bool LockStorageManager::LoadCredentialStatus(DlCredentialStatus &credentialStatus, uint8_t index)
{
	Nrf::PersistentStorageNode id = CreateIndexNode(index, &mCredentialStatus);

	return LoadDataToObject(&id, credentialStatus);
}

bool LockStorageManager::StoreCredentialType(CredentialTypeEnum credentialType, uint8_t index)
{
	Nrf::PersistentStorageNode id = CreateIndexNode(index, &mCredentialType);

	return Nrf::PersistentStorage::Instance().Store(&id, &credentialType, sizeof(credentialType));
}

bool LockStorageManager::LoadCredentialType(CredentialTypeEnum &credentialType, uint8_t index)
{
	Nrf::PersistentStorageNode id = CreateIndexNode(index, &mCredentialType);

	return LoadDataToObject(&id, credentialType);
}

bool LockStorageManager::StoreCredentialCreatedBy(uint8_t createdBy, uint8_t index)
{
	Nrf::PersistentStorageNode id = CreateIndexNode(index, &mCredentialCreatedBy);

	return Nrf::PersistentStorage::Instance().Store(&id, &createdBy, sizeof(createdBy));
}

bool LockStorageManager::LoadCredentialCreatedBy(uint8_t &createdBy, uint8_t index)
{
	Nrf::PersistentStorageNode id = CreateIndexNode(index, &mCredentialCreatedBy);

	return LoadDataToObject(&id, createdBy);
}

bool LockStorageManager::StoreCredentialLastModifiedBy(uint8_t lastModifiedBy, uint8_t index)
{
	Nrf::PersistentStorageNode id = CreateIndexNode(index, &mCredentialLastModifiedBy);

	return Nrf::PersistentStorage::Instance().Store(&id, &lastModifiedBy, sizeof(lastModifiedBy));
}

bool LockStorageManager::LoadCredentialLastModifiedBy(uint8_t &lastModifiedBy, uint8_t index)
{
	Nrf::PersistentStorageNode id = CreateIndexNode(index, &mCredentialLastModifiedBy);

	return LoadDataToObject(&id, lastModifiedBy);
}

bool LockStorageManager::StoreCredentialSecret(const uint8_t *secret, size_t secretSize, uint8_t index)
{
	Nrf::PersistentStorageNode id = CreateIndexNode(index, &mCredentialSecret);

	return Nrf::PersistentStorage::Instance().Store(&id, secret, secretSize);
}

bool LockStorageManager::LoadCredentialSecret(uint8_t *secret, size_t secretSize, uint8_t index)
{
	Nrf::PersistentStorageNode id = CreateIndexNode(index, &mCredentialSecret);
	size_t readSize = 0;

	PersistentStorage::Instance().Load(&id, secret, secretSize, readSize);
	bool result = readSize == secretSize?true:false;
	return result;
}

bool LockStorageManager::StoreCredentialSecretSize(size_t secretSize, uint8_t index)
{
	Nrf::PersistentStorageNode id = CreateIndexNode(index, &mCredentialSecretSize);

	return Nrf::PersistentStorage::Instance().Store(&id, &secretSize, sizeof(secretSize));
}

bool LockStorageManager::LoadCredentialSecretSize(size_t &secretSize, uint8_t index)
{
	Nrf::PersistentStorageNode id = CreateIndexNode(index, &mCredentialSecretSize);

	return LoadDataToObject(&id, secretSize);
}

} /* namespace Nrf */
```

## src/lock_storage_manager.h
```c
/*
 * Copyright (c) 2023 Nordic Semiconductor ASA
 *
 * SPDX-License-Identifier: LicenseRef-Nordic-5-Clause
 */

#pragma once

#include "persistent_storage/persistent_storage_util.h"
#include "bolt_lock_manager.h"

namespace Nrf {

class LockStorageManager {
public:
	static constexpr auto kMaxIndexLength = 3;

	LockStorageManager()
		: mLock("lk", strlen("lk")),
		mUsersCount("usrs_cnt",strlen("usrs_cnt"), &mLock),
		mUser("usr", strlen("usr"), &mLock),
		mUserData("usr_data", strlen("usr_data"), &mUser),
		mUserUniqueId("usr_uid", strlen("usr_uid"), &mUser),
		mUserStatus("usr_status", strlen("usr_status"), &mUser),
		mUserType("usr_type", strlen("usr_type"), &mUser),
		mUserCreateBy("usr_createdby", strlen("usr_createdby"), &mUser),
		mUserLastModifiedBy("usr_modifiedby", strlen("usr_modifiedby"), &mUser),
		mUserCredentialRule("usr_cred_rule", strlen("usr_cred_rule"), &mUser),
		mCredentialsCount("cred_cnt", strlen("cred_cnt"), &mLock),
		mCredential("cred", strlen("cred"), &mLock),
		mCredentialStatus("cred_status", strlen("cred_status"), &mCredential),
		mCredentialType("cred_type", strlen("cred_type"), &mCredential),
		mCredentialCreatedBy("cred_createdby", strlen("cred_createdby"), &mCredential),
		mCredentialLastModifiedBy("cred_lastmodifiedby", strlen("cred_lastmodifiedby"), &mCredential),
		mCredentialSecret("cred_scr", strlen("cred_scr"), &mCredential),
		mCredentialSecretSize("cred_scr_sz", strlen("cred_scr_sz"), &mCredential)
	{
	}

	static LockStorageManager &Instance()
	{
		static LockStorageManager sInstance;
		return sInstance;
	}

	bool Init() { return PersistentStorage::Instance().Init(); }
	bool StoreUsersCount(uint8_t count);
	bool LoadUsersCount(uint8_t &count);
	bool StoreUserData(BoltLockManager::UserData userData, uint8_t index);
	bool LoadUserData(BoltLockManager::UserData &userData, uint8_t index);
	bool StoreUserUniqueID(uint32_t userUniqueId, uint8_t index);
	bool LoadUserUniqueID(uint32_t &userUniqueId, uint8_t index);
	bool StoreUserStatus(UserStatusEnum userStatus, uint8_t index);
	bool LoadUserStatus(UserStatusEnum &userStatus, uint8_t index);
	bool StoreUserType(UserTypeEnum userType, uint8_t index);
	bool LoadUserType(UserTypeEnum &userType, uint8_t index);
	bool StoreUserCreatedBy(uint8_t createdBy, uint8_t index);
	bool LoadUserCreatedBy(uint8_t &createdBy, uint8_t index);
	bool StoreUserLastModifiedBy(uint8_t lastModifiedBy, uint8_t index);
	bool LoadUserLastModifiedBy(uint8_t &lastModifiedBy, uint8_t index);

	bool StoreUserCredentialRule(CredentialRuleEnum credentialRule, uint8_t index);
	bool LoadUserCredentialRule(CredentialRuleEnum &credentialRule, uint8_t index);
	bool StoreCredentialsCount(uint8_t count);
	bool LoadCredentialsCount(uint8_t &count);
	bool StoreCredentialStatus(DlCredentialStatus credentialStatus, uint8_t index);
	bool LoadCredentialStatus(DlCredentialStatus &credentialStatus, uint8_t index);
	bool StoreCredentialType(CredentialTypeEnum credentialType, uint8_t index);
	bool LoadCredentialType(CredentialTypeEnum &credentialType, uint8_t index);
	bool StoreCredentialCreatedBy(uint8_t createdBy, uint8_t index);
	bool LoadCredentialCreatedBy(uint8_t &createdBy, uint8_t index);
	bool StoreCredentialLastModifiedBy(uint8_t lastModifiedBy, uint8_t index);
	bool LoadCredentialLastModifiedBy(uint8_t &lastModifiedBy, uint8_t index);
	bool StoreCredentialSecret(const uint8_t *secret, size_t secretSize, uint8_t index);
	bool LoadCredentialSecret(uint8_t *secret, size_t secretSize, uint8_t index);
	bool StoreCredentialSecretSize(size_t secretSize, uint8_t index);
	bool LoadCredentialSecretSize(size_t &secretSize, uint8_t index);
private:
	PersistentStorageNode mLock;
	PersistentStorageNode mUsersCount;
	PersistentStorageNode mUser;
	PersistentStorageNode mUserData;
	PersistentStorageNode mUserUniqueId;
	PersistentStorageNode mUserStatus;
	PersistentStorageNode mUserType;
	PersistentStorageNode mUserCreateBy;
	PersistentStorageNode mUserLastModifiedBy;
	PersistentStorageNode mUserCredentialRule;

	PersistentStorageNode mCredentialsCount;
	PersistentStorageNode mCredential;
	PersistentStorageNode mCredentialStatus;
	PersistentStorageNode mCredentialType;
	PersistentStorageNode mCredentialCreatedBy;
	PersistentStorageNode mCredentialLastModifiedBy;
	PersistentStorageNode mCredentialSecret;
	PersistentStorageNode mCredentialSecretSize;
};

} /* namespace Nrf */
```

## src/matter_lock_shell.cpp
```c
#include "bolt_lock_manager.h"

#include <zephyr/shell/shell.h>

#include <cstdio>
#include <cstdlib>

#include <string>

#include <lib/core/DataModelTypes.h>
#include <lib/support/CodeUtils.h>

using std::string;
using namespace ::chip;

static int CreateUserCredentialHandler(const struct shell *shell, size_t argc, char **argv)
{
	bool ret;
	uint8_t userIndex = strtoul(argv[1], nullptr, 0);
	uint32_t userUniqueID = strtoul(argv[2], nullptr, 0);
	uint8_t credentialIndex = strtoul(argv[3], nullptr, 0);
	char *credentialData = nullptr;
	if (argv[4]) {
		credentialData = argv[4];
	}

	CredentialStruct credential{ CredentialTypeEnum::kPin, credentialIndex };
	ret = BoltLockMgr().SetUser(userIndex, kMaxValidFabricIndex, kMaxValidFabricIndex,
					chip::CharSpan(),
					userUniqueID, UserStatusEnum::kOccupiedEnabled, UserTypeEnum::kUnrestrictedUser,
					CredentialRuleEnum::kSingle, &credential, 1);
	if (!ret) {
		goto exit;
	}
	BoltLockMgr().SetCredential(credentialIndex, kMaxValidFabricIndex, kMaxValidFabricIndex, DlCredentialStatus::kOccupied, CredentialTypeEnum::kPin, ByteSpan(Uint8::from_const_char(credentialData), strlen(credentialData)));
	if (!ret) {
		goto exit;
	}
	shell_fprintf(shell, SHELL_INFO, "Done\n");
	return ret;
exit:
	shell_fprintf(shell, SHELL_INFO, "Fail\n");
	return ret;
}

static int ClearUserCredentialHandler(const struct shell *shell, size_t argc, char **argv)
{
	bool ret;
	uint8_t userIndex = strtoul(argv[1], nullptr, 0);
	uint8_t credentialIndex = strtoul(argv[2], nullptr, 0);

	CredentialStruct credential{ CredentialTypeEnum::kPin, 0 };
	ret = BoltLockMgr().SetUser(userIndex, 0, 0,
					chip::CharSpan(),
					0, UserStatusEnum::kAvailable, UserTypeEnum::kUnrestrictedUser,
					CredentialRuleEnum::kSingle, &credential, 0);
	if (!ret) {
		goto exit;
	}
	BoltLockMgr().SetCredential(credentialIndex, 0, 0, DlCredentialStatus::kAvailable, CredentialTypeEnum::kPin, chip::ByteSpan());
	if (!ret) {
		goto exit;
	}
	shell_fprintf(shell, SHELL_INFO, "Done\n");
	return ret;
exit:
	shell_fprintf(shell, SHELL_INFO, "Fail\n");
	return ret;
}

#ifdef CONFIG_LOCK_ENABLE_DEBUG
static void PrintUsersHandler(const struct shell *shell, size_t argc, char **argv)
{
	for (size_t idxUsr = 0; idxUsr < CONFIG_LOCK_MAX_NUM_USERS; ++idxUsr) {
		BoltLockMgr().PrintUserdata(idxUsr + 1);
	}
	shell_fprintf(shell, SHELL_INFO, "Done\n");
}

static void PrintCredentialsHandler(const struct shell *shell, size_t argc, char **argv)
{
	for (size_t idxCred = 0; idxCred < CONFIG_LOCK_MAX_NUM_CREDENTIALS_PER_TYPE; ++idxCred) {
		BoltLockMgr().PrintCredential(CredentialTypeEnum::kPin, idxCred + 1);
	}
	shell_fprintf(shell, SHELL_INFO, "Done\n");
}
#endif//CONFIG_LOCK_ENABLE_DEBUG

SHELL_STATIC_SUBCMD_SET_CREATE(
	sub_matter_lock,
	SHELL_CMD_ARG(
		createusercredential, NULL,
		"Create a new credential and a new user record. \n"
		"Usage: createusercredential <user_index> <user_unique_id> <credential_index> <credential_data> \n",
		CreateUserCredentialHandler, 5, 0),
	SHELL_CMD_ARG(
		clearusercredential, NULL,
		"Clear a credential and a user record. \n"
		"Usage: clearusercredential <user_index> <credential_index> \n",
		ClearUserCredentialHandler, 3, 0),
#ifdef CONFIG_LOCK_ENABLE_DEBUG
	SHELL_CMD_ARG(
		printusers, NULL,
		"Print all user data. \n"
		"Usage: printusers \n",
		PrintUsersHandler, 1, 0),
	SHELL_CMD_ARG(
		printcredentials, NULL,
		"Print all credential data. \n"
		"Usage: printcredentials \n",
		PrintCredentialsHandler, 1, 0),
#endif//CONFIG_LOCK_ENABLE_DEBUG
	SHELL_SUBCMD_SET_END);

SHELL_CMD_REGISTER(matter_lock, &sub_matter_lock, "matter_lock commands", NULL);
```

## src/zcl_callbacks.cpp
```c
/*
 * Copyright (c) 2021 Nordic Semiconductor ASA
 *
 * SPDX-License-Identifier: LicenseRef-Nordic-5-Clause
 */

#include "app_task.h"
#include "bolt_lock_manager.h"

#include <app-common/zap-generated/attributes/Accessors.h>
#include <app-common/zap-generated/ids/Clusters.h>
#include <app/ConcreteAttributePath.h>
#include <app/clusters/door-lock-server/door-lock-server.h>
#include <lib/support/CodeUtils.h>

using namespace ::chip;
using namespace ::chip::app::Clusters;
using namespace ::chip::app::Clusters::DoorLock;

void MatterPostAttributeChangeCallback(const chip::app::ConcreteAttributePath &attributePath, uint8_t type,
				       uint16_t size, uint8_t *value)
{
	VerifyOrReturn(attributePath.mClusterId == DoorLock::Id);

	if (attributePath.mAttributeId == DoorLock::Attributes::LockState::Id) {
		/* Post events only if current lock state is different than given */
		switch (*value) {
		case to_underlying(DlLockState::kLocked):
			BoltLockMgr().Lock(BoltLockManager::OperationSource::kRemote);
			break;
		case to_underlying(DlLockState::kUnlocked):
			BoltLockMgr().Unlock(BoltLockManager::OperationSource::kRemote);
			break;
		default:
			break;
		}
	} else if (attributePath.mAttributeId == DoorLock::Attributes::RequirePINforRemoteOperation::Id) {
		BoltLockMgr().SetRequirePIN(*value);
	}
}

bool emberAfPluginDoorLockGetUser(EndpointId endpointId, uint16_t userIndex, EmberAfPluginDoorLockUserInfo &user)
{
	return BoltLockMgr().GetUser(userIndex, user);
}

bool emberAfPluginDoorLockSetUser(EndpointId endpointId, uint16_t userIndex, FabricIndex creator, FabricIndex modifier,
				  const CharSpan &userName, uint32_t uniqueId, UserStatusEnum userStatus,
				  UserTypeEnum userType, CredentialRuleEnum credentialRule,
				  const CredentialStruct *credentials, size_t totalCredentials)
{
	return BoltLockMgr().SetUser(userIndex, creator, modifier, userName, uniqueId, userStatus, userType,
				     credentialRule, credentials, totalCredentials);
}

bool emberAfPluginDoorLockGetCredential(EndpointId endpointId, uint16_t credentialIndex,
					CredentialTypeEnum credentialType,
					EmberAfPluginDoorLockCredentialInfo &credential)
{
	return BoltLockMgr().GetCredential(credentialIndex, credentialType, credential);
}

bool emberAfPluginDoorLockSetCredential(EndpointId endpointId, uint16_t credentialIndex, FabricIndex creator,
					FabricIndex modifier, DlCredentialStatus credentialStatus,
					CredentialTypeEnum credentialType, const ByteSpan &secret)
{
	return BoltLockMgr().SetCredential(credentialIndex, creator, modifier, credentialStatus, credentialType,
					   secret);
}

bool emberAfPluginDoorLockOnDoorLockCommand(EndpointId endpointId, const Optional<ByteSpan> &pinCode,
					    OperationErrorEnum &err)
{
	bool result = BoltLockMgr().ValidatePIN(pinCode, err);

	/* Handle changing attribute state on command reception */
	if (result) {
		BoltLockMgr().Lock(BoltLockManager::OperationSource::kRemote);
	}

	return result;
}

bool emberAfPluginDoorLockOnDoorUnlockCommand(EndpointId endpointId, const Optional<ByteSpan> &pinCode,
					      OperationErrorEnum &err)
{
	bool result = BoltLockMgr().ValidatePIN(pinCode, err);

	/* Handle changing attribute state on command reception */
	if (result) {
		BoltLockMgr().Unlock(BoltLockManager::OperationSource::kRemote);
	}

	return result;
}

void emberAfDoorLockClusterInitCallback(EndpointId endpoint)
{
	DoorLockServer::Instance().InitServer(endpoint);

	const auto logOnFailure = [](EmberAfStatus status, const char *attributeName) {
		if (status != EMBER_ZCL_STATUS_SUCCESS) {
			ChipLogError(Zcl, "Failed to set DoorLock %s: %x", attributeName, status);
		}
	};

	logOnFailure(DoorLock::Attributes::LockType::Set(endpoint, DlLockType::kDeadBolt), "type");
	logOnFailure(DoorLock::Attributes::NumberOfTotalUsersSupported::Set(endpoint, CONFIG_LOCK_MAX_NUM_USERS),
		     "number of users");
	logOnFailure(DoorLock::Attributes::NumberOfPINUsersSupported::Set(endpoint,
									  CONFIG_LOCK_MAX_NUM_CREDENTIALS_PER_TYPE),
		     "number of PIN users");
	logOnFailure(DoorLock::Attributes::NumberOfRFIDUsersSupported::Set(endpoint, 0), "number of RFID users");
	logOnFailure(DoorLock::Attributes::NumberOfCredentialsSupportedPerUser::Set(
			     endpoint, CONFIG_LOCK_MAX_NUM_CREDENTIALS_PER_USER),
		     "number of credentials per user");

#ifdef CONFIG_LOCK_SCHEDULES
	logOnFailure(DoorLock::Attributes::NumberOfWeekDaySchedulesSupportedPerUser::Set(
			     endpoint, CONFIG_LOCK_MAX_WEEKDAY_SCHEDULES_PER_USER),
		     "number of WeekDay schedules per user");
	logOnFailure(DoorLock::Attributes::NumberOfYearDaySchedulesSupportedPerUser::Set(
			     endpoint, CONFIG_LOCK_MAX_YEARDAY_SCHEDULES_PER_USER),
		     "number of YearDay schedules per user");
	logOnFailure(DoorLock::Attributes::NumberOfHolidaySchedulesSupported::Set(endpoint,
										  CONFIG_LOCK_MAX_HOLIDAY_SCHEDULES),
		     "number of holiday schedules");
#endif /* CONFIG_LOCK_SCHEDULES */

	AppTask::Instance().UpdateClusterState(BoltLockMgr().GetState(),
					       BoltLockManager::OperationSource::kUnspecified);
}

#ifdef CONFIG_LOCK_SCHEDULES

DlStatus emberAfPluginDoorLockGetSchedule(chip::EndpointId endpointId, uint8_t weekdayIndex, uint16_t userIndex,
					  EmberAfPluginDoorLockWeekDaySchedule &schedule)
{
	return BoltLockMgr().GetWeekDaySchedule(weekdayIndex, userIndex, schedule);
}

DlStatus emberAfPluginDoorLockGetSchedule(chip::EndpointId endpointId, uint8_t yearDayIndex, uint16_t userIndex,
					  EmberAfPluginDoorLockYearDaySchedule &schedule)
{
	return BoltLockMgr().GetYearDaySchedule(yearDayIndex, userIndex, schedule);
}

DlStatus emberAfPluginDoorLockGetSchedule(chip::EndpointId endpointId, uint8_t holidayIndex,
					  EmberAfPluginDoorLockHolidaySchedule &holidaySchedule)
{
	return BoltLockMgr().GetHolidaySchedule(holidayIndex, holidaySchedule);
}

DlStatus emberAfPluginDoorLockSetSchedule(chip::EndpointId endpointId, uint8_t weekdayIndex, uint16_t userIndex,
					  DlScheduleStatus status, DaysMaskMap daysMask, uint8_t startHour,
					  uint8_t startMinute, uint8_t endHour, uint8_t endMinute)
{
	return BoltLockMgr().SetWeekDaySchedule(weekdayIndex, userIndex, status, daysMask, startHour, startMinute,
						endHour, endMinute);
}

DlStatus emberAfPluginDoorLockSetSchedule(chip::EndpointId endpointId, uint8_t yearDayIndex, uint16_t userIndex,
					  DlScheduleStatus status, uint32_t localStartTime, uint32_t localEndTime)
{
	return BoltLockMgr().SetYearDaySchedule(yearDayIndex, userIndex, status, localStartTime, localEndTime);
}

DlStatus emberAfPluginDoorLockSetSchedule(chip::EndpointId endpointId, uint8_t holidayIndex, DlScheduleStatus status,
					  uint32_t localStartTime, uint32_t localEndTime,
					  OperatingModeEnum operatingMode)
{
	return BoltLockMgr().SetHolidaySchedule(holidayIndex, status, localStartTime, localEndTime, operatingMode);
}

#endif /* CONFIG_LOCK_SCHEDULES */
```
