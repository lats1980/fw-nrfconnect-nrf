## applications/serial_lte_modem/src/http_c/Kconfig
```kconfig
#
# Copyright (c) 2020 Nordic Semiconductor ASA
#
# SPDX-License-Identifier: LicenseRef-BSD-5-Clause-Nordic

config SLM_HTTPC
	bool "HTTP Client support in SLM"
	select HTTP_CLIENT
```

## applications/serial_lte_modem/src/hw_rev/Kconfig
```kconfig
#
# Copyright (c) 2021 Nordic Semiconductor ASA
#
# SPDX-License-Identifier: LicenseRef-Nordic-5-Clause

config SLM_HW_REV
	bool "Hardware revision support in SLM"
	select ADC
```

## applications/serial_lte_modem/src/stats/Kconfig
```kconfig
#
# Copyright (c) 2021 Nordic Semiconductor ASA
#
# SPDX-License-Identifier: LicenseRef-BSD-5-Clause-Nordic

config SLM_STATS
	bool "SLM statistics"

config SLM_STATS_BATTERY_INTERVAL
	int "Interval to check battery level in ms"
	default 60000
```

## applications/serial_lte_modem/src/user_config/Kconfig
```kconfig
#
# Copyright (c) 2021 Nordic Semiconductor ASA
#
# SPDX-License-Identifier: LicenseRef-Nordic-5-Clause

config SLM_UC
	bool "Settings support in SLM"
	default y
	select FLASH
	select SETTINGS
	select FCB
	select MPU_ALLOW_FLASH_WRITE
	select FLASH_PAGE_LAYOUT
	select FLASH_MAP
```

## drivers/sensor/max17261ll/Kconfig
```kconfig
#
#  Copyright (c) 2019 Nordic Semiconductor ASA
#
#  SPDX-License-Identifier: LicenseRef-BSD-5-Clause-Nordic
#

config MAX17261LL
	bool "MAX17261 Fuel Gauge (low-level)"
	depends on I2C
	help
	  Enable I2C-based driver for MAX17261 Fuel Gauge. This driver exposes
	  the MAX17261's registers directly for read/write/verified write
	  operations, for external control or other special use.
```

## modules/openthread/Kconfig.dectnr
```kconfig
config OPENTHREAD_OVER_DECTNR_PHY
	bool "Support for OpenThread over DECT NR+ PHY"
	select NRF_MODEM_LIB
	select HWINFO

config OPENTHREAD_OVER_DECTNR_PHY_FREQUENCY
	int "Openthread DECT NR PHY frequency"
	default 531
	help
	  The absolute channel frequency number for the transmission.
	  See 5.4.2 of DECT-SPEC "DECT-2020 NR Part 2".

config OPENTHREAD_OVER_DECTNR_DEFAULT_TX_MCS
	int "Default transmission MCS"
	default 0
	help
	  The default transmission MCS (Modulation and Coding Scheme) for the PHY.

config OPENTHREAD_OVER_DECTNR_DEFAULT_TX_POWER
	int "Default transmission power level"
	default 13

config OPENTHREAD_OVER_DECTNR_RSSI_LEVEL
	int "Expected antenna signal level of the reception."
	default -103

config OPENTHREAD_OVER_DECTNR_LBT_THRESHOLD_MAX
	int "The listen before talk maximum RSSI threshold, in dBm."
	default -80
	help
	  See 5.1.2 of DECT-SPEC "DECT-2020 NR Part 4".

config DECT_RX_STACK_SIZE
	int "DECT RX stack size"
	default 800

config OT_DECT_RX_BUFFERS
	int "OpenThread over DECT NR+ PHY receive buffers"
	default 16
```

## samples/matter/common/src/Kconfig
```kconfig
#
# Copyright (c) 2023 Nordic Semiconductor
#
# SPDX-License-Identifier: LicenseRef-Nordic-5-Clause
#

config NCS_SAMPLE_MATTER_PERSISTENT_STORAGE
	bool "Persistent storage support for Matter samples"
	help
	  Matter persistent storage support with the configurable backend.
```

## samples/openthread/coap_client/boards/nrf9151dk_nrf9151_ns.conf
```kconfig
# Enable Custom OpenThread features set
CONFIG_OPENTHREAD_USER_CUSTOM_LIBRARY=y

# Dect NR
CONFIG_NRF_MODEM_LINK_BINARY_DECT_PHY=y
CONFIG_OPENTHREAD_OVER_DECTNR_PHY=y
CONFIG_PSA_CRYPTO_DRIVER_CC3XX=y
CONFIG_MODEM_ANTENNA_AT_COEX0=""

# Optimze for memory
CONFIG_PM_PARTITION_SIZE_TFM_SRAM=0x8000
CONFIG_PM_PARTITION_SIZE_TFM=0x20000
CONFIG_NET_BUF_DATA_SIZE=700
CONFIG_OPENTHREAD_THREAD_STACK_SIZE=8192
CONFIG_SHELL_STACK_SIZE=4096

# Enable Hardware AES CCM
CONFIG_OPENTHREAD_HARDWARE_AES_CCM=y
CONFIG_TFM_PROFILE_TYPE_SMALL=y

# Enable network socket
CONFIG_NET_SOCKETS_OFFLOAD=n
CONFIG_NET_SOCKETS=y
```
